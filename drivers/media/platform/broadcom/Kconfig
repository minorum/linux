## drivers/media/platform/broadcom/Kconfig
```kconfig
# SPDX-License-Identifier: GPL-2.0

config VIDEO_BCM2153_GE
	tristate "Broadcom BCM2153 graphics engine"
	depends on VIDEO_DEV && V4L_MEM2MEM_DRIVERS && OF && HAS_DMA
	depends on ARM || COMPILE_TEST
	select V4L2_MEM2MEM_DEV
	select VIDEOBUF2_VMALLOC
	help
	  Memory-to-memory BGRX transfers through the BCM2153 graphics engine.
	  Uses private DMA buffers and supports images up to 240 by 400 pixels.

config VIDEO_BCM2835_UNICAM
	tristate "Broadcom BCM283x/BCM271x Unicam video capture driver"
	depends on ARCH_BCM2835 || COMPILE_TEST
	depends on COMMON_CLK && PM
	depends on VIDEO_DEV
	select MEDIA_CONTROLLER
	select V4L2_FWNODE
	select VIDEO_V4L2_SUBDEV_API
	select VIDEOBUF2_DMA_CONTIG
	help
	  Say Y here to enable support for the BCM283x/BCM271x CSI-2 receiver.
	  This is a V4L2 driver that controls the CSI-2 receiver directly,
	  independently from the VC4 firmware.

	  To compile this driver as a module, choose M here. The module will be
	  called bcm2835-unicam.
```

## drivers/media/platform/sprd/Kconfig
```kconfig
# SPDX-License-Identifier: GPL-2.0-only
config VIDEO_SC9830_ROTATOR
	bool "Spreadtrum SC9830 DCAM rotator"
	depends on V4L_MEM2MEM_DRIVERS && OF && HAS_DMA
	depends on ARCH_SC9830 || COMPILE_TEST
	depends on INTERCONNECT_SC9830
	select MFD_SYSCON
	select VIDEOBUF2_DMA_CONTIG
	select V4L2_MEM2MEM_DEV
	help
	  RGB565 memory-to-memory rotation using the SC9830 DCAM engine.
	  Only contiguous MMAP buffers and translation-disabled MMU state
	  are supported. Jobs use a five-second completion budget.
```

## drivers/net/wireless/mediatek/mt6628/Kconfig
```kconfig
# SPDX-License-Identifier: GPL-2.0-only
config MT6628
	tristate "MediaTek MT6628 SDIO"
	depends on MMC && MAC80211
	select CRC32
	select FW_LOADER
	select REGMAP
	help
	  Station-only legacy 2.4 GHz support for MediaTek MT6628 SDIO devices.
	  Uses mac80211 management with vendor firmware.
	  This driver is under development.

	  To compile this driver as a module, choose M here. The module
	  will be called mt6628.
```

## drivers/net/wireless/sprd/Kconfig
```kconfig
# SPDX-License-Identifier: GPL-2.0-only
config WLAN_VENDOR_SPRD
	bool "Spreadtrum wireless devices"
	default y
	help
	  Enable the configuration menu for Spreadtrum wireless devices.
	  Individual chip drivers are selected below and can be built as
	  modules. Disable this option if no Spreadtrum connectivity device
	  is present; unrelated wireless vendor drivers remain available.

if WLAN_VENDOR_SPRD

config SC2331
	tristate "Spreadtrum SC2331 connectivity support"
	depends on SERIAL_DEV_BUS && OF && MMC && CFG80211
	select CRC_ITU_T
	help
	  Boots the SC2331 connectivity controller through its UART ROM
	  protocol and loads its firmware using serdev and SDIO.
	  Requires factory-calibrated connectivity power, reset and reference
	clock providers. Supports station scanning; association and data
	traffic are not available yet.

endif
```

## drivers/pmdomain/sprd/Kconfig
```kconfig
# SPDX-License-Identifier: GPL-2.0-only
config SC9830_GPU_PD
	bool "Spreadtrum SC9830 GPU power domain"
	depends on ARCH_SC9830 || COMPILE_TEST
	depends on OF && PM && COMMON_CLK
	select MFD_SYSCON
	select PM_GENERIC_DOMAINS
	help
	  Support GPU power sequencing on Spreadtrum SC9830.
	  The provider retains clock configuration across power cycles and
	  waits for stable power status before allowing GPU register access.
	  Power-on failures prevent further consumer activation.

config SC9830_MM_PD
	bool "Spreadtrum SC9830 multimedia power domain"
	depends on ARCH_SC9830 || COMPILE_TEST
	depends on OF && PM
	select MFD_SYSCON
	select PM_GENERIC_DOMAINS
	help
	  Enable the multimedia power domain on Spreadtrum SC9830.
	  The domain retains its clock configuration across power cycles.
	  Only an initially powered-off domain can be acquired.
	  Register access failures prevent further consumer activation.
```
