## Documentation/devicetree/bindings/regulator/sprd,sc2723-regulator.yaml
```yaml
# SPDX-License-Identifier: GPL-2.0-only OR BSD-2-Clause
%YAML 1.2
---
$id: http://devicetree.org/schemas/regulator/sprd,sc2723-regulator.yaml#
$schema: http://devicetree.org/meta-schemas/core.yaml#

title: Spreadtrum SC2723 CPU and fixed-voltage regulators

maintainers:
  - Orson Zhai <orsonzhai@gmail.com>
  - Baolin Wang <baolin.wang7@gmail.com>
  - Chunyan Zhang <zhang.lyra@gmail.com>

description: |
  Factory-calibrated connectivity supplies used at 1.6 V (vddcon) and
  3.3 V (vddwifipa), and the touchscreen supply at 3 V (vddsim2).
  Other operating voltages are currently unsupported.
  Calibration state bit 7 at eFuse byte 0 must be clear. The connectivity
  trim occupies bits 105 through 111; the Wi-Fi PA trim occupies bits
  164 through 169. The trims are centered at 64 and 32 respectively.
  The always-on CPU supply supports linear or coarse/trim selector encoding,
  selected by the PMIC mode register. CPU voltages describe raw selector values;
  request-dependent factory compensation is applied by the CPU OPP policy.
  The SIM2 trim occupies bits 206 through 211, centered at 32. Its trim is
  scaled from the factory 1.8 V reference to the requested 3 V supply.
  The eMMC I/O and core supplies retain their boot-programmed 1.8 V and 3 V
  selectors with OTP compensation enabled. Voltage changes are unsupported.
  The panel supply vddkpled retains its firmware voltage selector. Its
  reported voltage uses the six-bit trim from eFuse bits 152 through 157,
  centered at 32 with a 3.3 V factory reference. Voltage changes are
  unsupported. Its calibration cells are
  supplied on the regulator child independently of connectivity calibration.
  The sensor supplies vdd18 and vdd28 retain their boot-programmed 1.8 V
  and 2.8 V selectors with OTP compensation enabled. Voltage changes are
  unsupported, and these shared supplies must remain always on.

allOf:
  - if:
      anyOf:
        - required: [vddarm]
        - required: [vddcon]
        - required: [vddwifipa]
        - required: [vddsim2]
    then:
      required: [nvmem-cells, nvmem-cell-names]
  - if:
      required: [vddsim2]
    then:
      properties:
        nvmem-cells:
          minItems: 4
        nvmem-cell-names:
          minItems: 4

properties:
  compatible:
    const: sprd,sc2723-regulator

  vdd18:
    type: object
    $ref: regulator.yaml#
    properties:
      regulator-min-microvolt:
        const: 1800000
      regulator-max-microvolt:
        const: 1800000
      regulator-always-on: true
      regulator-boot-on: true
    required:
      - regulator-min-microvolt
      - regulator-max-microvolt
      - regulator-always-on
      - regulator-boot-on
    unevaluatedProperties: false

  vdd28:
    type: object
    $ref: regulator.yaml#
    properties:
      regulator-min-microvolt:
        const: 2800000
      regulator-max-microvolt:
        const: 2800000
      regulator-always-on: true
      regulator-boot-on: true
    required:
      - regulator-min-microvolt
      - regulator-max-microvolt
      - regulator-always-on
      - regulator-boot-on
    unevaluatedProperties: false

  vddgen0:
    type: object
    $ref: regulator.yaml#
    properties:
      regulator-min-microvolt:
        const: 1800000
      regulator-max-microvolt:
        const: 1800000
      regulator-always-on: true
      regulator-boot-on: true
    required:
      - regulator-min-microvolt
      - regulator-max-microvolt
      - regulator-always-on
      - regulator-boot-on
    unevaluatedProperties: false

  vddemmccore:
    type: object
    $ref: regulator.yaml#
    properties:
      regulator-min-microvolt:
        const: 3000000
      regulator-max-microvolt:
        const: 3000000
      regulator-always-on: true
      regulator-boot-on: true
    required:
      - regulator-min-microvolt
      - regulator-max-microvolt
      - regulator-always-on
      - regulator-boot-on
    unevaluatedProperties: false

  vddkpled:
    type: object
    $ref: regulator.yaml#
    properties:
      regulator-min-microvolt:
        minimum: 1200000
        maximum: 3760000
      regulator-max-microvolt:
        minimum: 1200000
        maximum: 3760000
      nvmem-cells:
        items:
          - description: Factory calibration validity bit
          - description: Panel voltage trim
      nvmem-cell-names:
        items:
          - const: calibration_state
          - const: vddkpled
    required:
      - regulator-min-microvolt
      - regulator-max-microvolt
      - nvmem-cells
      - nvmem-cell-names
    unevaluatedProperties: false

  nvmem-cells:
    minItems: 3
    items:
      - description: Factory calibration validity bit
      - description: Connectivity voltage trim
      - description: Wi-Fi PA voltage trim
      - description: SIM2 voltage trim

  nvmem-cell-names:
    minItems: 3
    items:
      - const: calibration_state
      - const: vddcon
      - const: vddwifipa
      - const: vddsim2

  vddsim2:
    type: object
    $ref: regulator.yaml#
    properties:
      regulator-min-microvolt:
        const: 3000000
      regulator-max-microvolt:
        const: 3000000
    unevaluatedProperties: false

  vddarm:
    type: object
    $ref: regulator.yaml#
    properties:
      regulator-min-microvolt:
        minimum: 600000
        maximum: 3125000
      regulator-max-microvolt:
        minimum: 600000
        maximum: 3125000
      regulator-always-on: true
      regulator-boot-on: true
    required:
      - regulator-min-microvolt
      - regulator-max-microvolt
      - regulator-always-on
      - regulator-boot-on
    unevaluatedProperties: false

  vddcon:
    type: object
    $ref: regulator.yaml#
    properties:
      regulator-min-microvolt:
        const: 1600000
      regulator-max-microvolt:
        const: 1600000
    unevaluatedProperties: false

  vddwifipa:
    type: object
    $ref: regulator.yaml#
    properties:
      regulator-min-microvolt:
        const: 3300000
      regulator-max-microvolt:
        const: 3300000
    unevaluatedProperties: false

required:
  - compatible

anyOf:
  - required: [nvmem-cells, nvmem-cell-names]
  - required: [vddgen0, vddemmccore]

additionalProperties: false
...
```

## Documentation/devicetree/bindings/reset/brcm,bcm2153-sdio-reset.yaml
```yaml
# SPDX-License-Identifier: (GPL-2.0-only OR BSD-2-Clause)
%YAML 1.2
---
$id: http://devicetree.org/schemas/reset/brcm,bcm2153-sdio-reset.yaml#
$schema: http://devicetree.org/meta-schemas/core.yaml#

title: Broadcom BCM2153 SDIO reset controller

maintainers:
  - minorum <mit.mis@gmail.com>

description:
  Bit 1 of the SDIO wrapper control word resets the external host interface.
  A reset pulse asserts this bit for at least 10 ms. Other bits are preserved.
  The wrapper interrupt-mask word is a separate resource owned by the host.

properties:
  compatible:
    const: brcm,bcm2153-sdio-reset

  reg:
    maxItems: 1

  '#reset-cells':
    const: 0

required:
  - compatible
  - reg
  - '#reset-cells'

additionalProperties: false

examples:
  - |
    reset-controller@8128000 {
        compatible = "brcm,bcm2153-sdio-reset";
        reg = <0x08128000 4>;
        #reset-cells = <0>;
    };
```

## Documentation/devicetree/bindings/rtc/maxim,max8991-rtc.yaml
```yaml
# SPDX-License-Identifier: (GPL-2.0-only OR BSD-2-Clause)
%YAML 1.2
---
$id: http://devicetree.org/schemas/rtc/maxim,max8991-rtc.yaml#
$schema: http://devicetree.org/meta-schemas/core.yaml#

title: Samsung GT-S5620 standalone RTC interface

maintainers:
  - minorum <mit.mis@gmail.com>

description:
  The Samsung GT-S5620 has an observed eight-byte BCD calendar interface at
  I2C address 0x68, starting at register 0. Its silicon ownership is unresolved.
  The compatible is a retained local identifier for the board-validated
  standalone read-only driver, not an established MAX8991 compatibility claim.

allOf:
  - $ref: rtc.yaml#

properties:
  compatible:
    const: maxim,max8991-rtc

  reg:
    const: 0x68

required:
  - compatible
  - reg

unevaluatedProperties: false

examples:
  - |
    i2c {
        #address-cells = <1>;
        #size-cells = <0>;

        rtc@68 {
            compatible = "maxim,max8991-rtc";
            reg = <0x68>;
        };
    };
```

## Documentation/devicetree/bindings/rtc/samsung,gt-s5620-rtc.yaml
```yaml
# SPDX-License-Identifier: (GPL-2.0-only OR BSD-2-Clause)
%YAML 1.2
---
$id: http://devicetree.org/schemas/rtc/samsung,gt-s5620-rtc.yaml#
$schema: http://devicetree.org/meta-schemas/core.yaml#

title: Samsung GT-S5620 standalone RTC interface

maintainers:
  - minorum <mit.mis@gmail.com>

description:
  The Samsung GT-S5620 has an observed eight-byte BCD calendar interface at
  I2C address 0x68, starting at register 0. Its silicon ownership is unresolved.
  The compatible describes this board-specific interface.

allOf:
  - $ref: rtc.yaml#

properties:
  compatible:
    const: samsung,gt-s5620-rtc

  reg:
    const: 0x68

required:
  - compatible
  - reg

unevaluatedProperties: false

examples:
  - |
    i2c {
        #address-cells = <1>;
        #size-cells = <0>;

        rtc@68 {
            compatible = "samsung,gt-s5620-rtc";
            reg = <0x68>;
        };
    };
```

## Documentation/devicetree/bindings/thermal/sprd,sc9830-thermal.yaml
```yaml
# SPDX-License-Identifier: GPL-2.0-only OR BSD-2-Clause
%YAML 1.2
---
$id: http://devicetree.org/schemas/thermal/sprd,sc9830-thermal.yaml#
$schema: http://devicetree.org/meta-schemas/core.yaml#

title: Spreadtrum SC9830 die temperature controller

maintainers:
  - minorum <mit.mis@gmail.com>

allOf:
  - $ref: thermal-sensor.yaml#

properties:
  compatible:
    const: sprd,sc9830-thermal
  reg:
    maxItems: 1
  clocks:
    items:
      - description: Controller bus gate
      - description: Thermal RTC gate
      - description: ARM sensor RTC gate
      - description: GPU sensor RTC gate
      - description: ARM automatic monitor gate
      - description: GPU automatic monitor gate
  clock-names:
    items:
      - const: enable
      - const: rtc
      - const: arm
      - const: gpu
      - const: arm-auto
      - const: gpu-auto
  resets:
    maxItems: 1
  nvmem-cells:
    maxItems: 1
  nvmem-cell-names:
    const: calibration
  '#thermal-sensor-cells':
    const: 1
    description: Sensor index, 0 for CPU and 1 for GPU.

required:
  - compatible
  - reg
  - clocks
  - clock-names
  - resets
  - nvmem-cells
  - nvmem-cell-names
  - '#thermal-sensor-cells'

unevaluatedProperties: false
```

## Documentation/devicetree/bindings/timer/brcm,bcm2153-gpt.yaml
```yaml
# SPDX-License-Identifier: (GPL-2.0-only OR BSD-2-Clause)
%YAML 1.2
---
$id: http://devicetree.org/schemas/timer/brcm,bcm2153-gpt.yaml#
$schema: http://devicetree.org/meta-schemas/core.yaml#

title: Broadcom BCM2153 general-purpose timers

maintainers:
  - minorum <mit.mis@gmail.com>

description:
  The block contains six 32-bit downcounters with individual control and
  reload registers, at a channel stride of 16 bytes. The slow clock input
  runs at 32768 Hz. Channel zero can provide a polled bootloader timebase.
  Linux uses channel zero as its clocksource and channel one for software
  one-shot clockevents. The node owns all six channels; unused channel
  interrupts are disabled during initialization.

properties:
  compatible:
    const: brcm,bcm2153-gpt

  reg:
    maxItems: 1

  clocks:
    maxItems: 1

  clock-names:
    const: slow

  interrupts:
    minItems: 1
    maxItems: 2
    description:
      The first interrupt is AP IRQ 11 for channels with interrupt assignment
      bit clear. The optional second interrupt is AP IRQ 62 for channels with
      that bit set. Linux requires the first interrupt; polled bootloader use
      does not require an interrupt.

required:
  - compatible
  - reg
  - clocks
  - clock-names

additionalProperties: false

examples:
  - |
    timer@8830100 {
        compatible = "brcm,bcm2153-gpt";
        reg = <0x08830100 0x60>;
        clocks = <&osc32k>;
        clock-names = "slow";
    };
```

## Documentation/devicetree/bindings/timer/sprd,sc9830-timer.yaml
```yaml
# SPDX-License-Identifier: GPL-2.0-only OR BSD-2-Clause
%YAML 1.2
---
$id: http://devicetree.org/schemas/timer/sprd,sc9830-timer.yaml#
$schema: http://devicetree.org/meta-schemas/core.yaml#

title: Spreadtrum SC9830 general-purpose timer

maintainers:
  - minorum <mit.mis@gmail.com>

description:
  Four CPU timer blocks each contain three 32-bit down counters. Channel zero
  provides a local clock event. CPU0 channel one provides the clock source.
  Resources, interrupts and clocks are ordered by CPU affinity f00 through f03.
  A single block describes the legacy CPU0-only configuration.

properties:
  compatible:
    const: sprd,sc9830-timer

  reg:
    minItems: 1
    maxItems: 4

  interrupts:
    minItems: 1
    maxItems: 4

  clocks:
    description: Gated functional clock for each timer register block.
    minItems: 1
    maxItems: 4

required:
  - compatible
  - reg
  - interrupts
  - clocks

oneOf:
  - properties:
      reg:
        maxItems: 1
      interrupts:
        maxItems: 1
      clocks:
        maxItems: 1
  - properties:
      reg:
        minItems: 4
      interrupts:
        minItems: 4
      clocks:
        minItems: 4

additionalProperties: false

examples:
  - |
    #include <dt-bindings/interrupt-controller/arm-gic.h>
    #include <dt-bindings/clock/sprd,sc9830-clk.h>

    timer@40050000 {
      compatible = "sprd,sc9830-timer";
      reg = <0x40050000 0x60>;
      interrupts = <GIC_SPI 28 IRQ_TYPE_LEVEL_HIGH>;
      clocks = <&aon_gate CLK_AON_TMR_EB>;
    };
```

## Documentation/devicetree/bindings/usb/mediatek,mt6577-musb-ram.yaml
```yaml
# SPDX-License-Identifier: GPL-2.0-only OR BSD-2-Clause
%YAML 1.2
---
$id: http://devicetree.org/schemas/usb/mediatek,mt6577-musb-ram.yaml#
$schema: http://devicetree.org/meta-schemas/core.yaml#

title: MediaTek MT6577 RAM-stage MUSB controller

maintainers:
  - Michal Andrzejczak <mit.mis@gmail.com>

description: |
  Peripheral-only PIO controller with clocks, power and PHY calibration
  retained from the preceding boot stage. This interface does not provide
  cold initialization or system power management.

allOf:
  - $ref: usb-drd.yaml#

properties:
  compatible:
    const: mediatek,mt6577-musb-ram

  reg:
    maxItems: 1

  interrupts:
    maxItems: 1

  interrupt-names:
    const: mc

  dr_mode:
    const: peripheral

required:
  - compatible
  - reg
  - interrupts
  - interrupt-names
  - dr_mode

unevaluatedProperties: false
```

## Documentation/devicetree/bindings/usb/mediatek,mt6577-musb.yaml
```yaml
# SPDX-License-Identifier: GPL-2.0-only OR BSD-2-Clause
%YAML 1.2
---
$id: http://devicetree.org/schemas/usb/mediatek,mt6577-musb.yaml#
$schema: http://devicetree.org/meta-schemas/core.yaml#

title: MediaTek MT6577 MUSB controller

maintainers:
  - Michal Andrzejczak <mit.mis@gmail.com>

description:
  Peripheral-only PIO controller with a separate USB PHY. Controller reset
  uses the local software reset register.

allOf:
  - $ref: usb-drd.yaml#

properties:
  compatible:
    const: mediatek,mt6577-musb

  reg:
    maxItems: 1

  interrupts:
    maxItems: 1

  interrupt-names:
    const: mc

  dr_mode:
    const: peripheral

  clocks:
    maxItems: 1

  clock-names:
    const: bus

  phys:
    maxItems: 1

  phy-names:
    const: usb2-phy

required:
  - compatible
  - reg
  - interrupts
  - interrupt-names
  - dr_mode
  - clocks
  - clock-names
  - phys
  - phy-names

unevaluatedProperties: false
```
