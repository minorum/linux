## Documentation/devicetree/bindings/usb/mediatek,mt8377-musb.yaml
```yaml
# SPDX-License-Identifier: GPL-2.0-only OR BSD-2-Clause
%YAML 1.2
---
$id: http://devicetree.org/schemas/usb/mediatek,mt8377-musb.yaml#
$schema: http://devicetree.org/meta-schemas/core.yaml#

title: MediaTek MT8377 MUSB controller

maintainers:
  - Michal Andrzejczak <mit.mis@gmail.com>

description:
  Peripheral-only PIO controller with a separate USB PHY. Controller reset
  uses the local software reset register.

allOf:
  - $ref: usb-drd.yaml#

properties:
  compatible:
    enum:
      - mediatek,mt8377-musb
      - mediatek,mt6577-musb

  reg:
    maxItems: 1

  interrupts:
    maxItems: 1

  interrupt-names:
    const: mc

  dr_mode:
    const: peripheral

  clocks:
    maxItems: 1

  clock-names:
    const: bus

  phys:
    maxItems: 1

  phy-names:
    const: usb2-phy

  power-supplies:
    $ref: /schemas/types.yaml#/definitions/phandle-array
    maxItems: 1
    items:
      maxItems: 1
    description:
      Charger receiving the USB peripheral's authorized input-current budget.
      Reset, configuration, suspend and disconnect update its current limit.

required:
  - compatible
  - reg
  - interrupts
  - interrupt-names
  - dr_mode
  - clocks
  - clock-names
  - phys
  - phy-names

unevaluatedProperties: false
```

## Documentation/devicetree/bindings/watchdog/brcm,bcm2153-wdt.yaml
```yaml
# SPDX-License-Identifier: (GPL-2.0-only OR BSD-2-Clause)
%YAML 1.2
---
$id: http://devicetree.org/schemas/watchdog/brcm,bcm2153-wdt.yaml#
$schema: http://devicetree.org/meta-schemas/core.yaml#

title: Broadcom BCM2153 application processor watchdog

maintainers:
  - minorum <mit.mis@gmail.com>

description:
  The AP watchdog is the second counter in the watchdog bank. It uses
  16-bit register accesses and a 1 Hz countdown derived from the slow clock.
  The first counter belongs to the modem processor and is separate.

allOf:
  - $ref: watchdog.yaml#

properties:
  compatible:
    const: brcm,bcm2153-wdt

  reg:
    maxItems: 1

  clocks:
    maxItems: 1

  clock-names:
    const: slow

  timeout-sec:
    minimum: 1
    maximum: 255
    default: 60

required:
  - compatible
  - reg
  - clocks
  - clock-names

unevaluatedProperties: false

examples:
  - |
    watchdog@88a0010 {
        compatible = "brcm,bcm2153-wdt";
        reg = <0x088a0010 8>;
        clocks = <&osc32k>;
        clock-names = "slow";
        timeout-sec = <60>;
    };
```

## Documentation/devicetree/bindings/watchdog/sprd,sc2723-wdt.yaml
```yaml
# SPDX-License-Identifier: (GPL-2.0-only OR BSD-2-Clause)
%YAML 1.2
---
$id: http://devicetree.org/schemas/watchdog/sprd,sc2723-wdt.yaml#
$schema: http://devicetree.org/meta-schemas/core.yaml#

title: Spreadtrum SC2723 analog watchdog

maintainers:
  - minorum <mit.mis@gmail.com>

allOf:
  - $ref: watchdog.yaml#

properties:
  compatible:
    const: sprd,sc2723-wdt

  reg:
    maxItems: 1

required:
  - compatible
  - reg

unevaluatedProperties: false

examples:
  - |
    pmic {
        #address-cells = <1>;
        #size-cells = <0>;
        watchdog@40 {
            compatible = "sprd,sc2723-wdt";
            reg = <0x40>;
        };
    };
```

## arch/arm/configs/samsung_j320fn_defconfig
```kconfig
CONFIG_LOCALVERSION="-j320fn"
# CONFIG_LOCALVERSION_AUTO is not set
CONFIG_SYSVIPC=y
CONFIG_HIGH_RES_TIMERS=y
# CONFIG_CROSS_MEMORY_ATTACH is not set
CONFIG_BPF_SYSCALL=y
CONFIG_BPF_JIT=y
CONFIG_BPF_LSM=y
CONFIG_PSI=y
CONFIG_LOG_BUF_SHIFT=18
CONFIG_CGROUPS=y
CONFIG_NAMESPACES=y
CONFIG_USER_NS=y
CONFIG_BLK_DEV_INITRD=y
# CONFIG_RD_BZIP2 is not set
# CONFIG_RD_LZMA is not set
# CONFIG_RD_XZ is not set
# CONFIG_RD_LZO is not set
# CONFIG_RD_LZ4 is not set
# CONFIG_INITRAMFS_PRESERVE_MTIME is not set
CONFIG_CC_OPTIMIZE_FOR_SIZE=y
CONFIG_EXPERT=y
# CONFIG_UID16 is not set
# CONFIG_FHANDLE is not set
# CONFIG_AIO is not set
# CONFIG_IO_URING is not set
# CONFIG_ADVISE_SYSCALLS is not set
# CONFIG_MEMBARRIER is not set
# CONFIG_RSEQ is not set
# CONFIG_CACHESTAT_SYSCALL is not set
CONFIG_PERF_EVENTS=y
CONFIG_SPRD_SC9830_DDR_PMU=y
CONFIG_PM=y
CONFIG_CPU_FREQ=y
CONFIG_CPU_FREQ_DEFAULT_GOV_SCHEDUTIL=y
CONFIG_CPU_FREQ_GOV_USERSPACE=y
CONFIG_CPU_FREQ_GOV_SCHEDUTIL=y
CONFIG_ARM_SC9830_CPUFREQ=y
CONFIG_SC9830_MM_PD=y
CONFIG_SPRD_SC9830_MM_CLK=y
CONFIG_INTERCONNECT=y
CONFIG_INTERCONNECT_SC9830=y
CONFIG_MAILBOX=y
CONFIG_SAMSUNG_J320FN_PM=y
CONFIG_ARCH_SC9830=y
CONFIG_SMP=y
CONFIG_NR_CPUS=4
CONFIG_HOTPLUG_CPU=y
CONFIG_SC9830_PM_SLEEP=y
CONFIG_WATCHDOG=y
CONFIG_SC2723_WATCHDOG=y
# CONFIG_HARDEN_BRANCH_PREDICTOR is not set
# CONFIG_HARDEN_BRANCH_HISTORY is not set
CONFIG_KUSER_HELPERS=y
# CONFIG_CACHE_L2X0 is not set
# CONFIG_ARM_PATCH_IDIV is not set
CONFIG_HIGHMEM=y
# CONFIG_ARM_PAN is not set
# CONFIG_ATAGS is not set
CONFIG_CMDLINE="console=ttyGS0 loglevel=7 pmos.nosplash"
CONFIG_VFP=y
CONFIG_NEON=y
CONFIG_KPROBES=y
# CONFIG_STACKPROTECTOR is not set
# CONFIG_VMAP_STACK is not set
# CONFIG_STRICT_KERNEL_RWX is not set
CONFIG_MODULES=y
CONFIG_MODULE_COMPRESS=y
CONFIG_MODULE_COMPRESS_ZSTD=y
CONFIG_MODULE_DECOMPRESS=y
# CONFIG_BLOCK_LEGACY_AUTOLOAD is not set
# CONFIG_BLK_DEV_WRITE_MOUNTED is not set
# CONFIG_BLK_DEBUG_FS is not set
CONFIG_PARTITION_ADVANCED=y
# CONFIG_MQ_IOSCHED_DEADLINE is not set
# CONFIG_MQ_IOSCHED_KYBER is not set
# CONFIG_IOSCHED_BFQ is not set
# CONFIG_CORE_DUMP_DEFAULT_ELF_HEADERS is not set
# CONFIG_SLAB_MERGE_DEFAULT is not set
# CONFIG_COMPAT_BRK is not set
# CONFIG_COMPACTION is not set
CONFIG_CMA=y
CONFIG_DMA_CMA=y
CONFIG_CMA_SIZE_MBYTES=16
# CONFIG_VM_EVENT_COUNTERS is not set
CONFIG_NET=y
CONFIG_PACKET=y
CONFIG_UNIX=y
# CONFIG_AF_UNIX_OOB is not set
CONFIG_INET=y
CONFIG_SYN_COOKIES=y
# CONFIG_INET_DIAG is not set
# CONFIG_IPV6 is not set
CONFIG_NETWORK_SECMARK=y
CONFIG_NETFILTER=y
# CONFIG_BQL is not set
CONFIG_CFG80211=y
# CONFIG_ETHTOOL_NETLINK is not set
CONFIG_UEVENT_HELPER=y
CONFIG_DEVTMPFS=y
CONFIG_DEVTMPFS_MOUNT=y
CONFIG_DRIVER_DEFERRED_PROBE_TIMEOUT=0
# CONFIG_STANDALONE is not set
# CONFIG_PREVENT_FIRMWARE_BUILD is not set
CONFIG_FW_LOADER_COMPRESS=y
CONFIG_FW_LOADER_COMPRESS_ZSTD=y
# CONFIG_ALLOW_DEV_COREDUMP is not set
CONFIG_ZRAM=m
CONFIG_BLK_DEV_LOOP=y
CONFIG_BLK_DEV_NBD=m
CONFIG_MD=y
CONFIG_BLK_DEV_DM=y
CONFIG_DM_CRYPT=y
CONFIG_NETDEVICES=y
# CONFIG_NET_CORE is not set
# CONFIG_ETHERNET is not set
CONFIG_SC2331=m
CONFIG_INPUT_EVDEV=m
CONFIG_KEYBOARD_GPIO=m
CONFIG_KEYBOARD_SC9830=m
CONFIG_KEYBOARD_TM2_TOUCHKEY=m
CONFIG_INPUT_TOUCHSCREEN=y
CONFIG_TOUCHSCREEN_IMAGIS=m
CONFIG_INPUT_MISC=y
CONFIG_INPUT_SC27XX_VIBRA=m
CONFIG_NEW_LEDS=y
CONFIG_LEDS_CLASS=y
# CONFIG_LEGACY_PTYS is not set
# CONFIG_LEGACY_TIOCSTI is not set
# CONFIG_LDISC_AUTOLOAD is not set
CONFIG_SERIAL_SPRD=y
CONFIG_NULL_TTY=m
CONFIG_SERIAL_DEV_BUS=y
# CONFIG_HW_RANDOM is not set
# CONFIG_DEVPORT is not set
CONFIG_I2C_CHARDEV=y
CONFIG_I2C_GPIO=m
CONFIG_I2C_SC9830=y
CONFIG_SPI=y
CONFIG_SPI_SPRD_ADI=y
CONFIG_PINCTRL=y
CONFIG_PINCTRL_SC9830=y
CONFIG_GPIOLIB=y
CONFIG_GPIO_SPRD=y
CONFIG_GPIO_PMIC_EIC_SPRD=m
CONFIG_POWER_SUPPLY=y
CONFIG_FUEL_GAUGE_SC27XX=y
CONFIG_CHARGER_SM5701=y
# CONFIG_HWMON is not set
CONFIG_THERMAL=y
CONFIG_GENERIC_ADC_THERMAL=y
CONFIG_MFD_SC27XX_PMIC=y
CONFIG_REGULATOR=y
CONFIG_REGULATOR_FIXED_VOLTAGE=m
CONFIG_REGULATOR_SC2723=y
CONFIG_MEDIA_SUPPORT=y
CONFIG_MEDIA_SUPPORT_FILTER=y
# CONFIG_MEDIA_SUBDRV_AUTOSELECT is not set
CONFIG_MEDIA_PLATFORM_SUPPORT=y
CONFIG_VIDEO_DEV=y
# CONFIG_MEDIA_CONTROLLER is not set
CONFIG_V4L_MEM2MEM_DRIVERS=y
CONFIG_VIDEO_SC9830_ROTATOR=y
CONFIG_DRM=y
CONFIG_DRM_SC9830_DISPC=y
CONFIG_DRM_SC9830_DSI=y
CONFIG_DRM_PANEL_SAMSUNG_S6E8AA5X01_AMS561RA01=y
CONFIG_BACKLIGHT_CLASS_DEVICE=y
CONFIG_DRM_LIMA=m
CONFIG_DEVFREQ_GOV_USERSPACE=y
CONFIG_SPRD_SC9830_GPU_CLK=y
CONFIG_SC9830_GPU_PD=y
CONFIG_DRM_VKMS=m
CONFIG_FB=y
CONFIG_FRAMEBUFFER_CONSOLE=y
CONFIG_USB_DWC2=y
CONFIG_USB_GADGET=y
CONFIG_U_SERIAL_CONSOLE=y
CONFIG_USB_CONFIGFS=y
CONFIG_USB_CONFIGFS_ACM=y
CONFIG_USB_CONFIGFS_ECM=y
CONFIG_USB_CONFIGFS_RNDIS=y
CONFIG_MMC=y
# CONFIG_PWRSEQ_EMMC is not set
# CONFIG_PWRSEQ_SIMPLE is not set
CONFIG_MMC_SDHCI=y
CONFIG_MMC_SDHCI_PLTFM=y
CONFIG_MMC_SDHCI_SPRD=y
CONFIG_RTC_CLASS=y
CONFIG_RTC_DRV_SC27XX=y
CONFIG_UDMABUF=y
# CONFIG_VIRTIO_MENU is not set
# CONFIG_VHOST_MENU is not set
CONFIG_HWSPINLOCK=y
CONFIG_HWSPINLOCK_SPRD=y
# CONFIG_IOMMU_SUPPORT is not set
CONFIG_IIO=y
CONFIG_SC27XX_ADC=y
CONFIG_NVMEM_SC27XX_EFUSE=y
CONFIG_EXT4_FS=y
# CONFIG_DNOTIFY is not set
CONFIG_VFAT_FS=y
CONFIG_TMPFS=y
CONFIG_TMPFS_POSIX_ACL=y
# CONFIG_MISC_FILESYSTEMS is not set
# CONFIG_NETWORK_FILESYSTEMS is not set
CONFIG_NLS_ASCII=y
CONFIG_SECURITY=y
CONFIG_SECURITYFS=y
CONFIG_SECURITY_PATH=y
CONFIG_CRYPTO_AES=y
CONFIG_CRYPTO_XTS=y
# CONFIG_CRC_OPTIMIZATIONS is not set
CONFIG_PRINTK_TIME=y
CONFIG_DYNAMIC_DEBUG=y
# CONFIG_SYMBOLIC_ERRNAME is not set
# CONFIG_DEBUG_BUGVERBOSE is not set
# CONFIG_DEBUG_MISC is not set
CONFIG_DEBUG_INFO_DWARF5=y
CONFIG_DEBUG_INFO_BTF=y
# CONFIG_SECTION_MISMATCH_WARN_ONLY is not set
CONFIG_DEBUG_FS=y
# CONFIG_SLUB_DEBUG is not set
CONFIG_STRICT_DEVMEM=y
# CONFIG_RUNTIME_TESTING_MENU is not set
```

## drivers/clk/sprd/Kconfig
```kconfig
# SPDX-License-Identifier: GPL-2.0-only
config SPRD_COMMON_CLK
	tristate "Clock support for Spreadtrum SoCs"
	depends on ARCH_SPRD || ARCH_SC9830 || COMPILE_TEST
	default ARCH_SPRD
	select REGMAP_MMIO

if SPRD_COMMON_CLK

# SoC Drivers

config SPRD_SC9830_GPU_CLK
	tristate "Spreadtrum SC9830 GPU clock"
	depends on ARCH_SC9830 || COMPILE_TEST
	depends on PM_GENERIC_DOMAINS
	help
	  Support the GPU clock mux and divider on Spreadtrum SC9830.
	  The provider acquires the GPU power domain before register access
	  and supports the stock GPU clock sources through the common clock
	  framework. Say Y to enable it for a built-in GPU power provider.

config SPRD_SC9830_CLK
	bool "Support for the Spreadtrum SC9830 clocks"
	depends on SPRD_COMMON_CLK=y
	select RESET_CONTROLLER
	select RESET_SIMPLE
	depends on ARCH_SC9830 || COMPILE_TEST
	help
	  Support for SC9830 peripheral clocks and gates, registered early
	  for the system timer. PLL programming remains provided by firmware.

config SPRD_SC9860_CLK
	tristate "Support for the Spreadtrum SC9860 clocks"
	depends on (ARM64 && ARCH_SPRD) || COMPILE_TEST
	default ARM64 && ARCH_SPRD

config SPRD_SC9830_MM_CLK
	tristate "Spreadtrum SC9830 multimedia clocks and resets"
	depends on ARCH_SC9830 || COMPILE_TEST
	depends on PM_GENERIC_DOMAINS
	select MFD_SYSCON
	depends on RESET_CONTROLLER
	help
	  DCAM and multimedia MMU gates with runtime power-domain ownership.
	  The provider controls multimedia AHB resets and the DCAM clock
	  selection using shared system registers. It requires the SC9830
	  multimedia power domain to be available before register access.

config SPRD_SC9863A_CLK
	tristate "Support for the Spreadtrum SC9863A clocks"
	depends on (ARM64 && ARCH_SPRD) || COMPILE_TEST
	default ARM64 && ARCH_SPRD
	help
	  Support for the global clock controller on sc9863a devices.
	  Say Y if you want to use peripheral devices on sc9863a SoC.

config SPRD_UMS512_CLK
	tristate "Support for the Spreadtrum UMS512 clocks"
	depends on (ARM64 && ARCH_SPRD) || COMPILE_TEST
	default ARM64 && ARCH_SPRD
	help
	  Support for the global clock controller on ums512 devices.
	  Say Y if you want to use peripheral devices on ums512 SoC.
endif
```

## drivers/gpu/drm/sprd/Kconfig
```kconfig
config DRM_SC9830_DISPC
	tristate "SC9830 display controller"
	depends on ARCH_SC9830 || COMPILE_TEST
	depends on DRM && OF
	select DRM_GEM_DMA_HELPER
	select DRM_KMS_HELPER
	select DRM_DISPLAY_HELPER
	select DRM_BRIDGE_CONNECTOR
	help
	  Enable the SC9830 display controller with one primary plane.
	  It supports linear XRGB8888 and RGB565 scanout through a DSI
	  bridge. Display clocks remain enabled while the driver is bound.
	  The module is called sc9830-dispc.

config DRM_SC9830_DSI
	tristate "SC9830 MIPI DSI host"
	depends on ARCH_SC9830 || COMPILE_TEST
	depends on DRM && OF && PM
	select DRM_DW_MIPI_DSI
	select MFD_SYSCON
	help
	  Enable the SC9830 DesignWare DSI host and its integrated PHY.
	  This supports RGB888 burst video at a fixed 500Mbit/s lane rate
	  using a 26MHz reference clock. A display controller and panel
	  driver are also required. The module is called sc9830-dsi.

config DRM_SPRD
	tristate "DRM Support for Unisoc SoCs Platform"
	depends on ARCH_SPRD || COMPILE_TEST
	depends on DRM && OF
	select DRM_GEM_DMA_HELPER
	select DRM_KMS_HELPER
	select DRM_MIPI_DSI
	select VIDEOMODE_HELPERS
	help
	  Choose this option if you have a Unisoc chipset.
	  If M is selected the module will be called sprd_drm.
```

## drivers/interconnect/sprd/Kconfig
```kconfig
# SPDX-License-Identifier: GPL-2.0-only
config INTERCONNECT_SC9830
	bool "Spreadtrum SC9830 DCAM interconnect"
	depends on ARCH_SC9830 || COMPILE_TEST
	depends on OF && HAS_IOMEM
	select MFD_SYSCON
	select REGMAP_MMIO
	help
	  Apply the SC9830 camera DDR arbitration profile while the DCAM
	  interconnect path has nonzero aggregate demand. The fixed profile
	  does not guarantee a requested bandwidth or change the DDR frequency.
	  The saved arbitration fields are restored when demand ends.
```
