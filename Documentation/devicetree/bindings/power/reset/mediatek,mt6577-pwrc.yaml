## Documentation/devicetree/bindings/power/reset/mediatek,mt6577-pwrc.yaml
```yaml
# SPDX-License-Identifier: (GPL-2.0-only OR BSD-2-Clause)
%YAML 1.2
---
$id: http://devicetree.org/schemas/power/reset/mediatek,mt6577-pwrc.yaml#
$schema: http://devicetree.org/meta-schemas/core.yaml#

title: MediaTek MT6577 RTC power controller

maintainers:
  - Michal Andrzejczak <mit.mis@gmail.com>

description:
  The RTC controls the PMIC PWRBB signal through its BBPU register.
  Its protected 16-bit registers are accessed over MMIO with a four-byte
  stride. This node owns the RTC register block for system power-off and
  the optional 32.768 kHz output clock.

properties:
  compatible:
    const: mediatek,mt6577-pwrc

  reg:
    maxItems: 1

  '#clock-cells':
    const: 0

required:
  - compatible
  - reg

additionalProperties: false

examples:
  - |
    power-controller@c1003000 {
        compatible = "mediatek,mt6577-pwrc";
        reg = <0xc1003000 0x7c>;
        #clock-cells = <0>;
    };
```

## Documentation/devicetree/bindings/power/reset/sprd,sc9830-reboot-mode.yaml
```yaml
# SPDX-License-Identifier: (GPL-2.0-only OR BSD-2-Clause)
%YAML 1.2
---
$id: http://devicetree.org/schemas/power/reset/sprd,sc9830-reboot-mode.yaml#
$schema: http://devicetree.org/meta-schemas/core.yaml#

title: Spreadtrum SC9830 retained SRAM reboot mailbox

maintainers:
  - Sebastian Reichel <sre@kernel.org>

description: |
  A 32-bit word in retained internal SRAM carries a reboot request to the
  bootloader. The mode values are defined by the bootloader protocol.

allOf:
  - $ref: reboot-mode.yaml#

properties:
  compatible:
    const: sprd,sc9830-reboot-mode

  reg:
    maxItems: 1

patternProperties:
  "^mode-.*$":
    maxItems: 1

required:
  - compatible
  - reg

unevaluatedProperties: false

examples:
  - |
    #include <dt-bindings/power/sprd,sc9830-reboot-mode.h>

    reboot-mode@f90 {
        compatible = "sprd,sc9830-reboot-mode";
        reg = <0xf90 0x4>;
        mode-normal = <SC9830_BOOT_NORMAL>;
        mode-recovery = <SC9830_BOOT_RECOVERY>;
        mode-bootloader = <SC9830_BOOT_FASTBOOT>;
    };
```

## Documentation/devicetree/bindings/power/sprd,sc9830-gpu-pwrc.yaml
```yaml
# SPDX-License-Identifier: (GPL-2.0-only OR BSD-2-Clause)
%YAML 1.2
---
$id: http://devicetree.org/schemas/power/sprd,sc9830-gpu-pwrc.yaml#
$schema: http://devicetree.org/meta-schemas/core.yaml#

title: Spreadtrum SC9830 GPU power domain

maintainers:
  - minorum <mit.mis@gmail.com>

description: |
  The GPU_TOP island uses the PMU power sequencer for power and isolation.
  Software controls its transitions with automatic shutdown disabled. The
  AON bus gate and LTEPLL source request are required during power-up, and
  the GPU clock mux and divider must be retained across power cycles.

allOf:
  - $ref: power-domain.yaml#

properties:
  compatible:
    const: sprd,sc9830-gpu-pwrc

  '#power-domain-cells':
    const: 0

  sprd,pmu:
    $ref: /schemas/types.yaml#/definitions/phandle
    description: PMU APB syscon.

  sprd,gpu-clk:
    $ref: /schemas/types.yaml#/definitions/phandle
    description: GPU clock syscon.

  clocks:
    items:
      - description: GPU AON bus gate
      - description: GPU LTEPLL source request gate

  clock-names:
    items:
      - const: bus
      - const: source

required:
  - compatible
  - '#power-domain-cells'
  - sprd,pmu
  - sprd,gpu-clk
  - clocks
  - clock-names

additionalProperties: false

examples:
  - |
    #include <dt-bindings/clock/sprd,sc9830-clk.h>

    power-controller-gpu {
        compatible = "sprd,sc9830-gpu-pwrc";
        #power-domain-cells = <0>;
        sprd,pmu = <&pmu>;
        sprd,gpu-clk = <&gpu_clk>;
        clocks = <&aon_gate CLK_GPU_EB>, <&pmu CLK_PMU_LTEPLL_GATE>;
        clock-names = "bus", "source";
    };
```

## Documentation/devicetree/bindings/power/sprd,sc9830-mm-pwrc.yaml
```yaml
# SPDX-License-Identifier: (GPL-2.0-only OR BSD-2-Clause)
%YAML 1.2
---
$id: http://devicetree.org/schemas/power/sprd,sc9830-mm-pwrc.yaml#
$schema: http://devicetree.org/meta-schemas/core.yaml#

title: Spreadtrum SC9830 multimedia power domain

maintainers:
  - minorum <mit.mis@gmail.com>

description: |
  The multimedia domain shares power and clock control registers with
  the PMU, AON APB, MM AHB and MM clock controllers. The provider retains
  the MM clock configuration across power cycles.

allOf:
  - $ref: power-domain.yaml#

properties:
  compatible:
    const: sprd,sc9830-mm-pwrc

  '#power-domain-cells':
    const: 0

  sprd,pmu:
    $ref: /schemas/types.yaml#/definitions/phandle
    description: PMU APB syscon.

  sprd,aon:
    $ref: /schemas/types.yaml#/definitions/phandle
    description: AON APB syscon.

  sprd,mm-ahb:
    $ref: /schemas/types.yaml#/definitions/phandle
    description: Multimedia AHB syscon.

  sprd,mm-clk:
    $ref: /schemas/types.yaml#/definitions/phandle
    description: Multimedia clock syscon.

required:
  - compatible
  - '#power-domain-cells'
  - sprd,pmu
  - sprd,aon
  - sprd,mm-ahb
  - sprd,mm-clk

additionalProperties: false

examples:
  - |
    power-controller {
        compatible = "sprd,sc9830-mm-pwrc";
        #power-domain-cells = <0>;
        sprd,pmu = <&pmu>;
        sprd,aon = <&aon_apb>;
        sprd,mm-ahb = <&mm_ahb>;
        sprd,mm-clk = <&mm_clk>;
    };
```

## Documentation/devicetree/bindings/power/sprd,sc9830-suspend.yaml
```yaml
# SPDX-License-Identifier: (GPL-2.0-only OR BSD-2-Clause)
%YAML 1.2
---
$id: http://devicetree.org/schemas/power/sprd,sc9830-suspend.yaml#
$schema: http://devicetree.org/meta-schemas/core.yaml#

title: Spreadtrum SC9830 suspend controller

maintainers:
  - minorum <mit.mis@gmail.com>

description: |
  Coordinates AP clock and DDR retention with the SC2723 analog policy.
  Firmware initializes DDR before Linux starts.

properties:
  compatible:
    const: sprd,sc9830-suspend

  sprd,ap-clk:
    $ref: /schemas/types.yaml#/definitions/phandle
    description: AP clock registers.

  sprd,ap-ahb:
    $ref: /schemas/types.yaml#/definitions/phandle
    description: AP AHB registers.

  sprd,ap-apb:
    $ref: /schemas/types.yaml#/definitions/phandle
    description: AP APB registers.

  sprd,aon:
    $ref: /schemas/types.yaml#/definitions/phandle
    description: Always-on APB registers.

  sprd,pub:
    $ref: /schemas/types.yaml#/definitions/phandle
    description: DDR monitor and PUB register resources.

  sprd,pmu:
    $ref: /schemas/types.yaml#/definitions/phandle
    description: Power management registers.

  sprd,dmc:
    $ref: /schemas/types.yaml#/definitions/phandle
    description: DDR controller registers.

  sprd,phy:
    $ref: /schemas/types.yaml#/definitions/phandle
    description: DDR PHY registers.

  sprd,pmic:
    $ref: /schemas/types.yaml#/definitions/phandle
    description: SC2723 analog register provider.

required:
  - compatible
  - sprd,ap-clk
  - sprd,ap-ahb
  - sprd,ap-apb
  - sprd,aon
  - sprd,pub
  - sprd,pmu
  - sprd,dmc
  - sprd,phy
  - sprd,pmic

additionalProperties: false

examples:
  - |
    suspend-controller {
        compatible = "sprd,sc9830-suspend";
        sprd,ap-clk = <&ap_clk>;
        sprd,ap-ahb = <&ap_ahb>;
        sprd,ap-apb = <&ap_apb>;
        sprd,aon = <&aon>;
        sprd,pub = <&pub>;
        sprd,pmu = <&pmu>;
        sprd,dmc = <&dmc>;
        sprd,phy = <&phy>;
        sprd,pmic = <&pmic>;
    };
```

## Documentation/devicetree/bindings/power/supply/onnn,ncp1851.yaml
```yaml
# SPDX-License-Identifier: (GPL-2.0-only OR BSD-2-Clause)
%YAML 1.2
---
$id: http://devicetree.org/schemas/power/supply/onnn,ncp1851.yaml#
$schema: http://devicetree.org/meta-schemas/core.yaml#

title: ON Semiconductor NCP1851 battery charger

maintainers:
  - Michal Andrzejczak <mit.mis@gmail.com>

description: |
  The NCP1851 and NCP1851A are single-cell switching battery chargers with
  programmable input and charge limits and an optional system power path.
  External voltage and temperature measurements provide battery monitoring.
  The example battery limits are illustrative and do not identify a particular
  board or battery pack.

allOf:
  - $ref: power-supply.yaml#
  - if:
      required:
        - onnn,power-path
    then:
      required:
        - onnn,system-voltage-microvolt

properties:
  compatible:
    enum:
      - onnn,ncp1851
      - onnn,ncp1851a

  reg:
    const: 0x36

  monitored-battery:
    description: |
      Battery information must specify constant-charge-current-max-microamp,
      constant-charge-voltage-max-microvolt, precharge-current-microamp,
      charge-term-current-microamp, over-voltage-threshold-microvolt and
      alert-celsius. Charging is permitted only inside the explicitly supplied
      alert-celsius normal temperature range. Missing or unsupported battery
      limits prevent charging; no pack characteristics are inferred.
      Normal precharge is fixed at 100 mA. The separate weak-battery current
      source is configured conservatively to the same nominal current.

  io-channels:
    items:
      - description: Battery voltage, processed in millivolts
      - description: Battery temperature, processed in millicelsius

  io-channel-names:
    items:
      - const: voltage
      - const: temperature

  input-current-limit-microamp:
    description: |
      Maximum input current permitted by the board. The available USB current
      budget is supplied dynamically and initially limited to 100 mA. Budgets
      below 100 mA inhibit charging.
    enum: [100000, 500000, 900000, 1500000]

  shunt-resistor-micro-ohms:
    description: Battery charge-current sense resistor
    const: 68000

  onnn,power-path:
    type: boolean
    description: Enable the system power path

  onnn,system-voltage-microvolt:
    description: System regulation target through VFET with a weak battery
    enum: [3100000, 3200000, 3300000, 3400000, 3500000, 3600000]

required:
  - compatible
  - reg
  - monitored-battery
  - io-channels
  - io-channel-names
  - input-current-limit-microamp
  - shunt-resistor-micro-ohms

unevaluatedProperties: false

examples:
  - |
    battery: battery {
      compatible = "simple-battery";
      constant-charge-current-max-microamp = <500000>;
      constant-charge-voltage-max-microvolt = <4200000>;
      precharge-current-microamp = <100000>;
      charge-term-current-microamp = <100000>;
      over-voltage-threshold-microvolt = <4300000>;
      alert-celsius = <0 40>;
    };

    i2c {
      #address-cells = <1>;
      #size-cells = <0>;

      charger@36 {
        compatible = "onnn,ncp1851";
        reg = <0x36>;
        monitored-battery = <&battery>;
        io-channels = <&adc 0>, <&thermistor>;
        io-channel-names = "voltage", "temperature";
        input-current-limit-microamp = <500000>;
        shunt-resistor-micro-ohms = <68000>;
        onnn,power-path;
        onnn,system-voltage-microvolt = <3300000>;
      };
    };
```

## Documentation/devicetree/bindings/power/supply/sc27xx-fg.yaml
```yaml
# SPDX-License-Identifier: GPL-2.0
%YAML 1.2
---
$id: http://devicetree.org/schemas/power/supply/sc27xx-fg.yaml#
$schema: http://devicetree.org/meta-schemas/core.yaml#

title: Spreadtrum SC27XX PMICs Fuel Gauge Unit Power Supply

maintainers:
  - Sebastian Reichel <sre@kernel.org>

properties:
  compatible:
    enum:
      - sprd,sc2720-fgu
      - sprd,sc2721-fgu
      - sprd,sc2723-fgu
      - sprd,sc2730-fgu
      - sprd,sc2731-fgu

  reg:
    maxItems: 1

  battery-detect-gpios:
    maxItems: 1

  bat-detect-gpio:
    maxItems: 1
    deprecated: true
    description: use battery-detect-gpios instead

  interrupts:
    maxItems: 1

  io-channels:
    items:
      - description: Battery Temperature ADC
      - description: Battery Charge Voltage ADC

  io-channel-names:
    items:
      - const: bat-temp
      - const: charge-vol

  nvmem-cells:
    minItems: 1
    maxItems: 2
    description: Calibration cells provided by eFuse device

  nvmem-cell-names:
    minItems: 1
    maxItems: 2

  sprd,calib-resistance-micro-ohms:
    description: real resistance of coulomb counter chip in micro Ohms

  monitored-battery: true

required:
  - compatible
  - reg
  - interrupts
  - nvmem-cells
  - nvmem-cell-names
  - sprd,calib-resistance-micro-ohms

allOf:
  - $ref: power-supply.yaml#
  - if:
      properties:
        compatible:
          const: sprd,sc2723-fgu
    then:
      properties:
        nvmem-cells:
          minItems: 2
          maxItems: 2
        nvmem-cell-names:
          items:
            - const: calibration_state
            - const: fgu_calib
    else:
      properties:
        nvmem-cells:
          maxItems: 1
        nvmem-cell-names:
          const: fgu_calib
      required:
        - battery-detect-gpios
        - io-channels
        - io-channel-names
        - monitored-battery

additionalProperties: false
...
```

## Documentation/devicetree/bindings/power/supply/siliconmitus,sm5701.yaml
```yaml
# SPDX-License-Identifier: (GPL-2.0-only OR BSD-2-Clause)
%YAML 1.2
---
$id: http://devicetree.org/schemas/power/supply/siliconmitus,sm5701.yaml#
$schema: http://devicetree.org/meta-schemas/core.yaml#

title: Silicon Mitus SM5701 charger

maintainers:
  - minorum <mit.mis@gmail.com>

description:
  The SM5701 integrates a battery charger, a boost converter and flash LED
  control. The charger input status is accessible over I2C.

properties:
  compatible:
    const: siliconmitus,sm5701

  reg:
    maxItems: 1

  interrupts:
    maxItems: 1

  led:
    type: object
    $ref: /schemas/leds/common.yaml#
    unevaluatedProperties: false
    properties:
      led-max-microamp:
        minimum: 10000
        maximum: 320000
        multipleOf: 10000
    required:
      - led-max-microamp

required:
  - compatible
  - reg

additionalProperties: false

examples:
  - |
    i2c {
      #address-cells = <1>;
      #size-cells = <0>;

      charger@49 {
        compatible = "siliconmitus,sm5701";
        reg = <0x49>;
      };
    };
```

## Documentation/devicetree/bindings/regulator/mediatek,mt6329.yaml
```yaml
# SPDX-License-Identifier: (GPL-2.0-only OR BSD-2-Clause)
%YAML 1.2
---
$id: http://devicetree.org/schemas/regulator/mediatek,mt6329.yaml#
$schema: http://devicetree.org/meta-schemas/core.yaml#

title: MediaTek MT6329 power management IC

maintainers:
  - Michal Andrzejczak <mit.mis@gmail.com>

description:
  The MT6329 exposes its bank 0 registers at I2C address 0x60. This binding
  describes the fixed 3.3 V VUSB and selectable-voltage VMC regulators.

properties:
  compatible:
    const: mediatek,mt6329
  reg:
    const: 0x60
  regulators:
    type: object
    properties:
      vusb:
        type: object
        $ref: regulator.yaml#
        properties:
          regulator-min-microvolt:
            const: 3300000
          regulator-max-microvolt:
            const: 3300000
        unevaluatedProperties: false
      vmc:
        type: object
        $ref: regulator.yaml#
        properties:
          regulator-min-microvolt:
            minimum: 1300000
            maximum: 3300000
          regulator-max-microvolt:
            minimum: 1300000
            maximum: 3300000
        unevaluatedProperties: false
    additionalProperties: false

required:
  - compatible
  - reg
  - regulators

additionalProperties: false

examples:
  - |
    i2c {
        #address-cells = <1>;
        #size-cells = <0>;
        pmic@60 {
            compatible = "mediatek,mt6329";
            reg = <0x60>;
            regulators {
                vusb {
                    regulator-name = "vusb";
                    regulator-min-microvolt = <3300000>;
                    regulator-max-microvolt = <3300000>;
                    regulator-always-on;
                };
                vmc {
                    regulator-name = "vmc";
                    regulator-min-microvolt = <3300000>;
                    regulator-max-microvolt = <3300000>;
                    regulator-always-on;
                };
            };
        };
    };
```
