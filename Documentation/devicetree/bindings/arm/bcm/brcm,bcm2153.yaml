## Documentation/devicetree/bindings/clock/sprd,sc9830-clk.yaml
```yaml
# SPDX-License-Identifier: GPL-2.0-only OR BSD-2-Clause
%YAML 1.2
---
$id: http://devicetree.org/schemas/clock/sprd,sc9830-clk.yaml#
$schema: http://devicetree.org/meta-schemas/core.yaml#

title: Spreadtrum SC9830 clock controllers

maintainers:
  - minorum <mit.mis@gmail.com>

properties:
  compatible:
    oneOf:
      - enum:
          - sprd,sc9830-aon-gate
          - sprd,sc9830-aon-clk
          - sprd,sc9830-aon-mux-clk
          - sprd,sc9830-ap-clk
          - sprd,sc9830-apapb-gate
          - sprd,sc9830-apahb-gate
      - items:
          - const: sprd,sc9830-aon-clk
          - const: syscon

  reg:
    maxItems: 1

  '#clock-cells':
    const: 1

  '#reset-cells':
    description: AP AHB reset bit index; bit 14 resets the eMMC host.
    const: 1

  clocks:
    minItems: 1
    maxItems: 8

  clock-names:
    minItems: 1
    maxItems: 8

allOf:
  - if:
      properties:
        compatible:
          not:
            contains:
              const: sprd,sc9830-apahb-gate
    then:
      properties:
        '#reset-cells': false
  - if:
      properties:
        compatible:
          contains:
            const: sprd,sc9830-aon-clk
    then:
      properties:
        clocks:
          minItems: 2
          maxItems: 6
        clock-names:
          minItems: 2
          items:
            - const: ext-26m
            - const: ext-32k
            - const: ext-26m-rf1
            - const: ext-4m
            - const: dpll-42m
            - const: mpll-56m
      required:
        - clocks
        - clock-names
  - if:
      properties:
        compatible:
          const: sprd,sc9830-aon-mux-clk
    then:
      properties:
        clocks:
          minItems: 8
          maxItems: 8
        clock-names:
          items:
            - const: ext-26m
            - const: twpll-192m
            - const: twpll-307m2
            - const: twpll-384m
            - const: twpll-512m
            - const: twpll-614m4
            - const: twpll-768m
            - const: dpll
      required:
        - clocks
        - clock-names
  - if:
      properties:
        compatible:
          const: sprd,sc9830-ap-clk
    then:
      properties:
        clocks:
          minItems: 4
          maxItems: 8
        clock-names:
          minItems: 4
          items:
            - const: ext-26m
            - const: twpll-48m
            - const: twpll-51m2
            - const: twpll-153m6
            - const: twpll-256m
            - const: twpll-307m2
            - const: twpll-384m
            - const: twpll-96m
      required:
        - clocks
        - clock-names
  - if:
      properties:
        compatible:
          const: sprd,sc9830-apapb-gate
    then:
      properties:
        clocks:
          minItems: 1
          maxItems: 2
        clock-names:
          minItems: 1
          items:
            - const: i2c2
            - const: uart0
      required:
        - clocks
        - clock-names
  - if:
      properties:
        compatible:
          const: sprd,sc9830-apahb-gate
    then:
      properties:
        clocks:
          minItems: 1
          maxItems: 4
        clock-names:
          minItems: 1
          items:
            - const: sdio0
            - const: sdio1
            - const: emmc
            - const: ext-26m
      required:
        - clocks
        - clock-names
  - if:
      properties:
        compatible:
          const: sprd,sc9830-aon-gate
    then:
      properties:
        clocks: false
        clock-names: false

required:
  - compatible
  - reg
  - '#clock-cells'

additionalProperties: false

examples:
  - |
    clock-controller@402e0000 {
        compatible = "sprd,sc9830-aon-gate";
        reg = <0x402e0000 0x3000>;
        #clock-cells = <1>;
    };
```

## Documentation/devicetree/bindings/clock/sprd,sc9830-gpu-clk.yaml
```yaml
# SPDX-License-Identifier: (GPL-2.0-only OR BSD-2-Clause)
%YAML 1.2
---
$id: http://devicetree.org/schemas/clock/sprd,sc9830-gpu-clk.yaml#
$schema: http://devicetree.org/meta-schemas/core.yaml#

title: Spreadtrum SC9830 GPU clock controller

maintainers:
  - minorum <mit.mis@gmail.com>

properties:
  compatible:
    items:
      - const: sprd,sc9830-gpu-clk
      - const: syscon

  reg:
    maxItems: 1

  '#clock-cells':
    const: 0

  clocks:
    items:
      - description: TWPLL 153.6 MHz
      - description: Requested LTEPLL divided by two, 614.4 MHz
      - description: TWPLL 256 MHz
      - description: TWPLL 307.2 MHz
      - description: TWPLL 384 MHz
      - description: TWPLL 512 MHz

  power-domains:
    maxItems: 1

required:
  - compatible
  - reg
  - '#clock-cells'
  - clocks
  - power-domains

additionalProperties: false
```

## Documentation/devicetree/bindings/clock/sprd,sc9830-mm-gate.yaml
```yaml
# SPDX-License-Identifier: GPL-2.0-only OR BSD-2-Clause
%YAML 1.2
---
$id: http://devicetree.org/schemas/clock/sprd,sc9830-mm-gate.yaml#
$schema: http://devicetree.org/meta-schemas/core.yaml#

title: Spreadtrum SC9830 multimedia clocks and resets

maintainers:
  - minorum <mit.mis@gmail.com>

properties:
  compatible:
    items:
      - const: sprd,sc9830-mm-gate
      - const: syscon

  reg:
    maxItems: 1

  '#clock-cells':
    const: 1

  '#reset-cells':
    description: |
      Multimedia AHB reset IDs 0 (DCAM), 1 (AXI), 10 (rotator) and
      32 (DCAM and AXI together).
    const: 1

  clocks:
    maxItems: 1

  clock-names:
    const: dcam-source

  power-domains:
    maxItems: 1

  sprd,mm-clk:
    $ref: /schemas/types.yaml#/definitions/phandle
    description: Multimedia clock selection syscon.

  sprd,pmu:
    $ref: /schemas/types.yaml#/definitions/phandle
    description: Always-on PMU syscon containing multimedia power status.

required:
  - compatible
  - reg
  - '#clock-cells'
  - '#reset-cells'
  - clocks
  - clock-names
  - power-domains
  - sprd,mm-clk
  - sprd,pmu

additionalProperties: false

examples:
  - |
    clock-controller@60d00000 {
        compatible = "sprd,sc9830-mm-gate", "syscon";
        reg = <0x60d00000 0x3000>;
        #clock-cells = <1>;
        #reset-cells = <1>;
        clocks = <&aon_gate 11>;
        clock-names = "dcam-source";
        power-domains = <&mm_domain>;
        sprd,mm-clk = <&mm_clk>;
        sprd,pmu = <&pmu>;
    };
```

## Documentation/devicetree/bindings/clock/sprd,sc9830-usb-clock.yaml
```yaml
# SPDX-License-Identifier: GPL-2.0-only OR BSD-2-Clause
%YAML 1.2
---
$id: http://devicetree.org/schemas/clock/sprd,sc9830-usb-clock.yaml#
$schema: http://devicetree.org/meta-schemas/core.yaml#

title: Spreadtrum SC9830 USB module gate for RAM bring-up

maintainers:
  - minorum <mit.mis@gmail.com>

description:
  Temporary representation of AP AHB enable bit 4. The parent clock tree
  remains firmware-initialized during the RAM boot experiment.

properties:
  compatible:
    const: sprd,sc9830-usb-clock

  reg:
    maxItems: 1

  '#clock-cells':
    const: 0

required:
  - compatible
  - reg
  - '#clock-cells'

additionalProperties: false
```

## Documentation/devicetree/bindings/display/brcm,bcm2153-dbi.yaml
```yaml
# SPDX-License-Identifier: (GPL-2.0-only OR BSD-2-Clause)
%YAML 1.2
---
$id: http://devicetree.org/schemas/display/brcm,bcm2153-dbi.yaml#
$schema: http://devicetree.org/meta-schemas/core.yaml#

title: Broadcom BCM2153 parallel Display Bus Interface

maintainers:
  - minorum <mit.mis@gmail.com>

properties:
  compatible:
    const: brcm,bcm2153-dbi

  reg:
    maxItems: 1

  clocks:
    maxItems: 1

  panel:
    type: object
    additionalProperties: false
    properties:
      compatible:
        const: samsung,gt-s5620-lcd
    required:
      - compatible

required:
  - compatible
  - reg

additionalProperties: false

examples:
  - |
    display@8030000 {
        compatible = "brcm,bcm2153-dbi";
        reg = <0x08030000 0x20>;

        panel {
            compatible = "samsung,gt-s5620-lcd";
        };
    };
```

## Documentation/devicetree/bindings/display/bridge/sprd,sc9830-dsi.yaml
```yaml
# SPDX-License-Identifier: (GPL-2.0-only OR BSD-2-Clause)
%YAML 1.2
---
$id: http://devicetree.org/schemas/display/bridge/sprd,sc9830-dsi.yaml#
$schema: http://devicetree.org/meta-schemas/core.yaml#

title: Spreadtrum SC9830 MIPI DSI host

maintainers:
  - minorum <mit.mis@gmail.com>

allOf:
  - $ref: snps,dw-mipi-dsi.yaml#

properties:
  compatible:
    const: sprd,sc9830-dsi

  reg:
    maxItems: 1

  clocks:
    items:
      - description: DSI AP-AHB bus gate
      - description: D-PHY 26MHz reference gate
      - description: D-PHY configuration gate

  clock-names:
    items:
      - const: pclk
      - const: ref
      - const: cfg

  resets:
    maxItems: 1

  reset-names:
    const: apb

  sprd,aon:
    $ref: /schemas/types.yaml#/definitions/phandle
    description: AON APB syscon containing the D-PHY power-down controls.

  ports: true

required:
  - compatible
  - reg
  - clocks
  - clock-names
  - resets
  - reset-names
  - sprd,aon
  - ports

unevaluatedProperties: false

examples:
  - |
    #include <dt-bindings/clock/sprd,sc9830-clk.h>

    dsi@21800000 {
        compatible = "sprd,sc9830-dsi";
        reg = <0x21800000 0x1000>;
        clocks = <&apahb CLK_DSI_EB>, <&apahb CLK_DPHY_REF_EB>,
                 <&apahb CLK_DPHY_CFG_EB>;
        clock-names = "pclk", "ref", "cfg";
        resets = <&apahb 0>;
        reset-names = "apb";
        sprd,aon = <&aon_gate>;

        ports {
            #address-cells = <1>;
            #size-cells = <0>;

            port@0 {
                reg = <0>;
                endpoint {
                    remote-endpoint = <&dispc_out>;
                };
            };

            port@1 {
                reg = <1>;
                endpoint {
                    remote-endpoint = <&panel_in>;
                };
            };
        };
    };
```

## Documentation/devicetree/bindings/display/mediatek/mediatek,mt8377-dpi.yaml
```yaml
# SPDX-License-Identifier: (GPL-2.0-only OR BSD-2-Clause)
%YAML 1.2
---
$id: http://devicetree.org/schemas/display/mediatek/mediatek,mt8377-dpi.yaml#
$schema: http://devicetree.org/meta-schemas/core.yaml#

title: MediaTek MT8377 DPI display controller

maintainers:
  - Michal Andrzejczak <mit.mis@gmail.com>

description:
  The MT8377 DPI controller includes framebuffer DMA and a parallel RGB
  timing generator. It is distinct from the DPI output blocks found in
  newer MediaTek display pipelines.
  The parallel output uses RGB888 on 24 data lines, including when a
  downstream bridge reports a fixed bus format.

properties:
  compatible:
    enum:
      - mediatek,mt8377-dpi
      - mediatek,mt6577-dpi

  reg:
    maxItems: 1

  interrupts:
    maxItems: 1

  clocks:
    items:
      - description: DPI engine gate
      - description: SMI LARB1 gate
      - description: SMI LARB1 EMI gate
      - description: MIPI TX PLL source

  clock-names:
    items:
      - const: engine
      - const: larb
      - const: larb-emi
      - const: pll

  mediatek,mmsys:
    $ref: /schemas/types.yaml#/definitions/phandle
    description: MMSYS configuration controller providing DPI pin routing

  power-domains:
    maxItems: 1

  port:
    $ref: /schemas/graph.yaml#/properties/port
    description: Parallel RGB output

required:
  - compatible
  - reg
  - interrupts
  - clocks
  - clock-names
  - mediatek,mmsys
  - port

additionalProperties: false

examples:
  - |
    #include <dt-bindings/interrupt-controller/arm-gic.h>
    #include <dt-bindings/interrupt-controller/irq.h>
    #include <dt-bindings/clock/mediatek,mt8377-mmsys.h>

    display-controller@c208c000 {
        compatible = "mediatek,mt8377-dpi";
        reg = <0xc208c000 0xb8>;
        interrupts = <GIC_SPI 11 IRQ_TYPE_LEVEL_LOW>;
        clocks = <&mmsys CLK_MT8377_MM_DPI>,
                 <&mmsys CLK_MT8377_MM_LARB1>,
                 <&mmsys CLK_MT8377_MM_LARB1_EMI>, <&mipi_tx>;
        clock-names = "engine", "larb", "larb-emi", "pll";
        mediatek,mmsys = <&mmsys>;

        port {
            dpi_out: endpoint {
                remote-endpoint = <&bridge_in>;
            };
        };
    };
```

## Documentation/devicetree/bindings/display/panel/modecom,freetab8001-display.yaml
```yaml
# SPDX-License-Identifier: (GPL-2.0-only OR BSD-2-Clause)
%YAML 1.2
---
$id: http://devicetree.org/schemas/display/panel/modecom,freetab8001-display.yaml#
$schema: http://devicetree.org/meta-schemas/core.yaml#

title: MODECOM FreeTAB 8001 display assembly

maintainers:
  - Michal Andrzejczak <mit.mis@gmail.com>

description:
  The fitted 1024x768 display assembly accepts parallel RGB888 and uses six
  board control signals with a fixed power sequence. The exact panel and
  intervening display component models are unknown.

allOf:
  - $ref: panel-common.yaml#

properties:
  compatible:
    const: modecom,freetab8001-display

  modecom,control-gpios:
    description:
      Active-high board controls in firmware power-up order, routed to SoC
      GPIOs 100, 66, 12, 49, 84 and 52 respectively. Their individual
      electrical roles are not identified. The first signal remains high
      during the power-down sequence.
    minItems: 6
    maxItems: 6

  backlight: true
  port: true

required:
  - compatible
  - modecom,control-gpios
  - backlight
  - port

additionalProperties: false

examples:
  - |
    #include <dt-bindings/gpio/gpio.h>

    panel {
        compatible = "modecom,freetab8001-display";
        modecom,control-gpios = <&gpio 100 GPIO_ACTIVE_HIGH>,
                                <&gpio 66 GPIO_ACTIVE_HIGH>,
                                <&gpio 12 GPIO_ACTIVE_HIGH>,
                                <&gpio 49 GPIO_ACTIVE_HIGH>,
                                <&gpio 84 GPIO_ACTIVE_HIGH>,
                                <&gpio 52 GPIO_ACTIVE_HIGH>;
        backlight = <&backlight>;

        port {
            panel_in: endpoint {
                remote-endpoint = <&dpi_out>;
            };
        };
    };
```

## Documentation/devicetree/bindings/display/sprd,sc9830-dispc.yaml
```yaml
# SPDX-License-Identifier: (GPL-2.0-only OR BSD-2-Clause)
%YAML 1.2
---
$id: http://devicetree.org/schemas/display/sprd,sc9830-dispc.yaml#
$schema: http://devicetree.org/meta-schemas/core.yaml#

title: Spreadtrum SC9830 display controller

maintainers:
  - minorum <mit.mis@gmail.com>

properties:
  compatible:
    const: sprd,sc9830-dispc

  reg:
    maxItems: 1

  interrupts:
    maxItems: 1

  clocks:
    items:
      - description: Display core mux/divider and AP-AHB gate
      - description: Display DBI clock
      - description: Display pixel clock
      - description: Display memory interface gate

  clock-names:
    items:
      - const: core
      - const: dbi
      - const: dpi
      - const: emc

  resets:
    maxItems: 1

  port:
    $ref: /schemas/graph.yaml#/properties/port
    description: Pixel output to the DSI host.

required:
  - compatible
  - reg
  - interrupts
  - clocks
  - clock-names
  - resets
  - port

additionalProperties: false

examples:
  - |
    #include <dt-bindings/clock/sprd,sc9830-clk.h>
    #include <dt-bindings/interrupt-controller/arm-gic.h>

    display-controller@20800000 {
        compatible = "sprd,sc9830-dispc";
        reg = <0x20800000 0x1000>;
        interrupts = <GIC_SPI 46 IRQ_TYPE_LEVEL_HIGH>;
        clocks = <&apahb CLK_DISPC_EB>, <&ap_clk CLK_DISPC_DBI>,
                 <&ap_clk CLK_DISPC_DPI>, <&aon_gate CLK_DISP_EMC_EB>;
        clock-names = "core", "dbi", "dpi", "emc";
        resets = <&apahb 1>;

        port {
            endpoint {
                remote-endpoint = <&dsi_in>;
            };
        };
    };
```
