## Documentation/devicetree/bindings/firmware/samsung,j320fn-pm.yaml
```yaml
# SPDX-License-Identifier: (GPL-2.0-only OR BSD-2-Clause)
%YAML 1.2
---
$id: http://devicetree.org/schemas/firmware/samsung,j320fn-pm.yaml#
$schema: http://devicetree.org/meta-schemas/core.yaml#

title: Samsung Galaxy J3 SM-J320FN PM firmware transport

maintainers:
  - Orson Zhai <orsonzhai@gmail.com>
  - Baolin Wang <baolin.wang7@gmail.com>
  - Chunyan Zhang <zhang.lyra@gmail.com>

description: |
  The Samsung SM-J320FN PM firmware exchanges DDR control messages with the
  application processor through two shared SRAM rings and a mailbox doorbell.
  The SRAM contains 128 eight-byte slots in each direction, followed by four
  32-bit reader and writer counters. This interface describes the installed
  Samsung firmware protocol, rather than a generic SC9830 firmware interface.

properties:
  compatible:
    const: samsung,j320fn-pm

  reg:
    maxItems: 1
    description: Shared transmit and receive rings and their counters.

  mboxes:
    maxItems: 1
    description: PM processor doorbell channel.

  mbox-names:
    items:
      - const: pm

  clocks:
    maxItems: 1

  clock-names:
    items:
      - const: emc

  '#clock-cells':
    const: 0
    description: |
      Provides the firmware-reported effective DDR clock. The input emc clock
      describes the inherited AON configuration and must not use this output.

required:
  - compatible
  - reg
  - mboxes
  - mbox-names
  - clocks
  - clock-names

additionalProperties: false

examples:
  - |
    #include <dt-bindings/clock/sprd,sc9830-clk.h>

    pm@5000c000 {
        compatible = "samsung,j320fn-pm";
        reg = <0x5000c000 0x1000>;
        mboxes = <&mailbox 1>;
        mbox-names = "pm";
        clocks = <&aon_mux CLK_EMC>;
        clock-names = "emc";
    };
```

## Documentation/devicetree/bindings/gpio/brcm,bcm2153-gpio.yaml
```yaml
# SPDX-License-Identifier: (GPL-2.0-only OR BSD-2-Clause)
%YAML 1.2
---
$id: http://devicetree.org/schemas/gpio/brcm,bcm2153-gpio.yaml#
$schema: http://devicetree.org/meta-schemas/core.yaml#

title: Broadcom BCM2153 GPIO controller

maintainers:
  - minorum <mit.mis@gmail.com>

properties:
  compatible:
    const: brcm,bcm2153-gpio

  reg:
    maxItems: 1

  gpio-controller: true

  "#gpio-cells":
    const: 2

  gpio-reserved-ranges: true

  interrupts:
    maxItems: 1

  interrupt-controller: true

  "#interrupt-cells":
    const: 2

required:
  - compatible
  - reg
  - gpio-controller
  - '#gpio-cells'
  - interrupts
  - interrupt-controller
  - '#interrupt-cells'

additionalProperties: false

examples:
  - |
    #include <dt-bindings/interrupt-controller/irq.h>

    gpio@88ce000 {
        compatible = "brcm,bcm2153-gpio";
        reg = <0x088ce000 0x58>;
        interrupts = <6 IRQ_TYPE_EDGE_RISING>;
        interrupt-controller;
        #interrupt-cells = <2>;
        gpio-controller;
        #gpio-cells = <2>;
    };
```

## Documentation/devicetree/bindings/i2c/brcm,bcm2153-i2c.yaml
```yaml
# SPDX-License-Identifier: (GPL-2.0-only OR BSD-2-Clause)
%YAML 1.2
---
$id: http://devicetree.org/schemas/i2c/brcm,bcm2153-i2c.yaml#
$schema: http://devicetree.org/meta-schemas/core.yaml#

title: Broadcom BCM2153 I2C controller

maintainers:
  - minorum <mit.mis@gmail.com>

allOf:
  - $ref: /schemas/i2c/i2c-controller.yaml#

properties:
  compatible:
    const: brcm,bcm2153-i2c

  reg:
    maxItems: 1

  interrupts:
    maxItems: 1

  clocks:
    maxItems: 1

required:
  - compatible
  - reg

unevaluatedProperties: false
```

## Documentation/devicetree/bindings/i2c/mediatek,mt6577-i2c-dual.yaml
```yaml
# SPDX-License-Identifier: (GPL-2.0-only OR BSD-2-Clause)
%YAML 1.2
---
$id: http://devicetree.org/schemas/i2c/mediatek,mt6577-i2c-dual.yaml#
$schema: http://devicetree.org/meta-schemas/core.yaml#

title: MediaTek MT6577 dual-channel I2C controller

maintainers:
  - Michal Andrzejczak <mit.mis@gmail.com>

description:
  The dual-channel controller has shared interrupt and reset registers.
  Channel1 supports SMBus byte-data access. Channel2 state is retained;
  shared clock and reset ownership must account for its independent users.
  The main clock has a fixed internal divide by16.

allOf:
  - $ref: /schemas/i2c/i2c-controller.yaml#

properties:
  compatible:
    const: mediatek,mt6577-i2c-dual
  reg:
    maxItems: 1
  interrupts:
    maxItems: 1
  clocks:
    maxItems: 1
  clock-names:
    const: main
  clock-frequency:
    const: 100000
  mediatek,use-push-pull:
    type: boolean
    description: Use push-pull instead of open-drain SCL and SDA outputs.

required:
  - compatible
  - reg
  - clocks
  - clock-names

unevaluatedProperties: false

examples:
  - |
    #include <dt-bindings/interrupt-controller/arm-gic.h>
    #include <dt-bindings/interrupt-controller/irq.h>
    i2c@c1014000 {
        compatible = "mediatek,mt6577-i2c-dual";
        reg = <0xc1014000 0xc0>;
        interrupts = <GIC_SPI 73 IRQ_TYPE_LEVEL_LOW>;
        clocks = <&i2c_dual>;
        clock-names = "main";
        clock-frequency = <100000>;
        #address-cells = <1>;
        #size-cells = <0>;
    };
```

## Documentation/devicetree/bindings/i2c/sprd,sc9830-i2c.yaml
```yaml
# SPDX-License-Identifier: GPL-2.0-only OR BSD-2-Clause
%YAML 1.2
---
$id: http://devicetree.org/schemas/i2c/sprd,sc9830-i2c.yaml#
$schema: http://devicetree.org/meta-schemas/core.yaml#

title: Spreadtrum SC9830 I2C controller

maintainers:
  - minorum <mit.mis@gmail.com>

allOf:
  - $ref: /schemas/i2c/i2c-controller.yaml#

properties:
  compatible:
    const: sprd,sc9830-i2c

  reg:
    maxItems: 1

  interrupts:
    maxItems: 1

  clocks:
    items:
      - description: I2C mux and divider clock, configured to 26 MHz
      - description: I2C module gate clock

  clock-names:
    items:
      - const: i2c
      - const: enable

  clock-frequency:
    enum: [100000, 400000]
    default: 100000

required:
  - compatible
  - reg
  - interrupts
  - clocks
  - clock-names

unevaluatedProperties: false

examples:
  - |
    #include <dt-bindings/clock/sprd,sc9830-clk.h>
    #include <dt-bindings/interrupt-controller/arm-gic.h>
    #include <dt-bindings/interrupt-controller/irq.h>

    i2c@70700000 {
        compatible = "sprd,sc9830-i2c";
        reg = <0x70700000 0x1000>;
        interrupts = <GIC_SPI 13 IRQ_TYPE_LEVEL_HIGH>;
        clocks = <&ap_clk CLK_I2C2>, <&apapb CLK_I2C2_EB>;
        clock-names = "i2c", "enable";
        #address-cells = <1>;
        #size-cells = <0>;
    };
```

## Documentation/devicetree/bindings/iio/adc/mediatek,mt6329-fgadc.yaml
```yaml
# SPDX-License-Identifier: (GPL-2.0-only OR BSD-2-Clause)
%YAML 1.2
---
$id: http://devicetree.org/schemas/iio/adc/mediatek,mt6329-fgadc.yaml#
$schema: http://devicetree.org/meta-schemas/core.yaml#

title: MediaTek MT6329 fuel gauge ADC

maintainers:
  - Michal Andrzejczak <mit.mis@gmail.com>

description:
  Battery current converter within the MT6329 PMIC. Current is positive
  into the battery and negative during discharge. The converter uses
  an external sense resistor and board-specific current calibration.
  With voltage and temperature inputs, it also monitors accumulated charge
  and registers the battery power supply.

allOf:
  - $ref: /schemas/power/supply/power-supply.yaml#
  - if:
      required:
        - monitored-battery
    then:
      required:
        - io-channels
        - io-channel-names

properties:
  compatible:
    const: mediatek,mt6329-fgadc

  '#io-channel-cells':
    const: 0

  va2-supply:
    description: Analog supply for the current converter.

  shunt-resistor-micro-ohms:
    description: Battery current sense resistance in micro-ohms.
    minimum: 1

  mediatek,current-calibration-percent:
    description: Board current gain correction, with 100 representing unity.
    minimum: 1

  io-channels:
    items:
      - description: Battery terminal voltage.
      - description: Battery temperature.

  io-channel-names:
    items:
      - const: voltage
      - const: temperature

  monitored-battery: true

  power-supplies: true

required:
  - compatible
  - '#io-channel-cells'
  - va2-supply
  - shunt-resistor-micro-ohms
  - mediatek,current-calibration-percent

additionalProperties: false

examples:
  - |
    current-sensor {
        compatible = "mediatek,mt6329-fgadc";
        #io-channel-cells = <0>;
        va2-supply = <&va2>;
        shunt-resistor-micro-ohms = <20000>;
        mediatek,current-calibration-percent = <101>;
    };
```
