## Documentation/devicetree/bindings/arm/bcm/brcm,bcm2153.yaml
```yaml
# SPDX-License-Identifier: (GPL-2.0-only OR BSD-2-Clause)
%YAML 1.2
---
$id: http://devicetree.org/schemas/arm/bcm/brcm,bcm2153.yaml#
$schema: http://devicetree.org/meta-schemas/core.yaml#

title: Broadcom BCM2153 boards

maintainers:
  - minorum <mit.mis@gmail.com>

properties:
  $nodename:
    const: '/'
  compatible:
    items:
      - const: samsung,gt-s5620
      - const: brcm,bcm2153

additionalProperties: true
```

## Documentation/devicetree/bindings/clock/brcm,bcm2153-sdio-clock.yaml
```yaml
# SPDX-License-Identifier: (GPL-2.0-only OR BSD-2-Clause)
%YAML 1.2
---
$id: http://devicetree.org/schemas/clock/brcm,bcm2153-sdio-clock.yaml#
$schema: http://devicetree.org/meta-schemas/core.yaml#

title: Broadcom BCM2153 SDIO clock

maintainers:
  - minorum <mit.mis@gmail.com>

description:
  The SDIO clock block contains a dedicated output gate and divider.
  Firmware must retain the nominal 52 MHz effective input. This block
  controls neither that input's initialization nor its upstream ancestry.

properties:
  compatible:
    const: brcm,bcm2153-sdio-clock

  reg:
    maxItems: 1

  '#clock-cells':
    const: 0

required:
  - compatible
  - reg
  - '#clock-cells'

additionalProperties: false

examples:
  - |
    clock-controller@8140038 {
        compatible = "brcm,bcm2153-sdio-clock";
        reg = <0x08140038 0x8>;
        #clock-cells = <0>;
    };
```

## Documentation/devicetree/bindings/clock/mediatek,mt6577-apmixedsys.yaml
```yaml
# SPDX-License-Identifier: (GPL-2.0-only OR BSD-2-Clause)
%YAML 1.2
---
$id: http://devicetree.org/schemas/clock/mediatek,mt6577-apmixedsys.yaml#
$schema: http://devicetree.org/meta-schemas/core.yaml#

title: MediaTek MT6577 analog clock controller

maintainers:
  - Michal Andrzejczak <mit.mis@gmail.com>

description:
  The analog clock controller provides MAINPLL and the nominal WPLL197MHz
  output. WPLL rate programming is not supported. Its firmware configuration
  is retained; shared firmware consumers require the WPLL output to remain on.

properties:
  compatible:
    const: mediatek,mt6577-apmixedsys
  reg:
    maxItems: 1
  clocks:
    maxItems: 1
  clock-names:
    items:
      - const: clk26m
  '#clock-cells':
    const: 1

required:
  - compatible
  - reg
  - clocks
  - clock-names
  - '#clock-cells'

additionalProperties: false

examples:
  - |
    clock-controller@c0007000 {
        compatible = "mediatek,mt6577-apmixedsys";
        reg = <0xc0007000 0x1000>;
        clocks = <&clk26m>;
        clock-names = "clk26m";
        #clock-cells = <1>;
    };
```

## Documentation/devicetree/bindings/clock/mediatek,mt6577-mmsys.yaml
```yaml
# SPDX-License-Identifier: (GPL-2.0-only OR BSD-2-Clause)
%YAML 1.2
---
$id: http://devicetree.org/schemas/clock/mediatek,mt6577-mmsys.yaml#
$schema: http://devicetree.org/meta-schemas/core.yaml#

title: MediaTek MT6577 multimedia clock gates

maintainers:
  - Michal Andrzejczak <mit.mis@gmail.com>

description:
  MMSYS provides the clock gates for the DPI engine and SMI memory fabric.
  Upstream clock sources are configured by firmware. Gate rates are unknown.

properties:
  compatible:
    items:
      - const: mediatek,mt6577-mmsys
      - const: syscon

  reg:
    maxItems: 1

  clocks:
    items:
      - description: Register bus clock

  clock-names:
    items:
      - const: bus

  '#clock-cells':
    const: 1

  power-domains:
    maxItems: 1

required:
  - compatible
  - reg
  - '#clock-cells'

additionalProperties: false

dependencies:
  clocks: [clock-names]
  clock-names: [clocks]

examples:
  - |
    clock-controller@c2080000 {
        compatible = "mediatek,mt6577-mmsys", "syscon";
        reg = <0xc2080000 0x1000>;
        #clock-cells = <1>;
    };
```

## Documentation/devicetree/bindings/clock/mediatek,mt6577-pericfg.yaml
```yaml
# SPDX-License-Identifier: (GPL-2.0-only OR BSD-2-Clause)
%YAML 1.2
---
$id: http://devicetree.org/schemas/clock/mediatek,mt6577-pericfg.yaml#
$schema: http://devicetree.org/meta-schemas/core.yaml#

title: MediaTek MT6577 peripheral clock controller

maintainers:
  - Michal Andrzejczak <mit.mis@gmail.com>

description:
  The peripheral controller provides the PWM functional reference and clock
  gates, the dual I2C gate, and the MSDC0 and MSDC3 source selectors and gates. PWM
  channels4 through6 share one gate. MSDC0 and MSDC3 support the 26MHz and nominal
  WPLL197MHz source selections. USB supports the nominal WPLL61MHz source;
  its alternative source is not supported. UART2 uses the AXI clock divided
  by four and has an independent gate.

properties:
  compatible:
    const: mediatek,mt6577-pericfg
  reg:
    maxItems: 1
  clocks:
    maxItems: 4
  clock-names:
    items:
      - const: axi
      - const: clk26m
      - const: wpll197
      - const: wpll61
  '#clock-cells':
    const: 1

required:
  - compatible
  - reg
  - clocks
  - clock-names
  - '#clock-cells'

additionalProperties: false

examples:
  - |
    #include <dt-bindings/clock/mediatek,mt6577-clk.h>
    clock-controller@c1000000 {
        compatible = "mediatek,mt6577-pericfg";
        reg = <0xc1000000 0x1000>;
        clocks = <&infracfg CLK_MT6577_AXI>, <&clk26m>,
                 <&apmixedsys CLK_MT6577_WPLL197>,
                 <&apmixedsys CLK_MT6577_WPLL61>;
        clock-names = "axi", "clk26m", "wpll197", "wpll61";
        #clock-cells = <1>;
    };
```

## Documentation/devicetree/bindings/clock/mediatek,mt8377-apmixedsys.yaml
```yaml
# SPDX-License-Identifier: (GPL-2.0-only OR BSD-2-Clause)
%YAML 1.2
---
$id: http://devicetree.org/schemas/clock/mediatek,mt8377-apmixedsys.yaml#
$schema: http://devicetree.org/meta-schemas/core.yaml#

title: MediaTek MT8377 analog clock controller

maintainers:
  - Michal Andrzejczak <mit.mis@gmail.com>

description:
  The analog clock controller provides MAINPLL, nominal WPLL197MHz and
  WPLL61MHz outputs, and UPLL enable control with an unknown output rate.
  PLL rate programming is not supported. Firmware configuration is retained;
  shared firmware consumers require these outputs to remain on.

properties:
  compatible:
    enum:
      - mediatek,mt8377-apmixedsys
      - mediatek,mt6577-apmixedsys
  reg:
    maxItems: 1
  clocks:
    maxItems: 1
  clock-names:
    items:
      - const: clk26m
  '#clock-cells':
    const: 1

required:
  - compatible
  - reg
  - clocks
  - clock-names
  - '#clock-cells'

additionalProperties: false

examples:
  - |
    clock-controller@c0007000 {
        compatible = "mediatek,mt8377-apmixedsys";
        reg = <0xc0007000 0x1000>;
        clocks = <&clk26m>;
        clock-names = "clk26m";
        #clock-cells = <1>;
    };
```

## Documentation/devicetree/bindings/clock/mediatek,mt8377-infracfg.yaml
```yaml
# SPDX-License-Identifier: (GPL-2.0-only OR BSD-2-Clause)
%YAML 1.2
---
$id: http://devicetree.org/schemas/clock/mediatek,mt8377-infracfg.yaml#
$schema: http://devicetree.org/meta-schemas/core.yaml#

title: MediaTek MT8377 infrastructure clock controller

maintainers:
  - Michal Andrzejczak <mit.mis@gmail.com>

description:
  The infrastructure controller selects and divides the AXI clock. The WPLL
  input is needed when that source is selected by firmware.

properties:
  compatible:
    enum:
      - mediatek,mt8377-infracfg
      - mediatek,mt6577-infracfg
  reg:
    maxItems: 1
  clocks:
    minItems: 2
    maxItems: 3
  clock-names:
    minItems: 2
    items:
      - const: clk26m
      - const: mainpll
      - const: wpll
  '#clock-cells':
    const: 1

required:
  - compatible
  - reg
  - clocks
  - clock-names
  - '#clock-cells'

additionalProperties: false

examples:
  - |
    #include <dt-bindings/clock/mediatek,mt8377-clk.h>
    clock-controller@c0001000 {
        compatible = "mediatek,mt8377-infracfg";
        reg = <0xc0001000 0x1000>;
        clocks = <&clk26m>, <&apmixedsys CLK_MT8377_MAINPLL>;
        clock-names = "clk26m", "mainpll";
        #clock-cells = <1>;
    };
```

## Documentation/devicetree/bindings/clock/mediatek,mt8377-mipi-tx.yaml
```yaml
# SPDX-License-Identifier: (GPL-2.0-only OR BSD-2-Clause)
%YAML 1.2
---
$id: http://devicetree.org/schemas/clock/mediatek,mt8377-mipi-tx.yaml#
$schema: http://devicetree.org/meta-schemas/core.yaml#

title: MediaTek MT8377 MIPI TX PLL

maintainers:
  - Michal Andrzejczak <mit.mis@gmail.com>

description:
  The MIPI TX block contains the PLL used as the DPI pixel-clock source.

properties:
  compatible:
    enum:
      - mediatek,mt8377-mipi-tx
      - mediatek,mt6577-mipi-tx

  reg:
    maxItems: 1

  clocks:
    items:
      - description: 26 MHz reference clock

  '#clock-cells':
    const: 0

  mediatek,mmsys:
    $ref: /schemas/types.yaml#/definitions/phandle
    description: MMSYS configuration controller

  mediatek,apmixedsys:
    $ref: /schemas/types.yaml#/definitions/phandle
    description: Analog clock configuration controller

  mediatek,infracfg:
    $ref: /schemas/types.yaml#/definitions/phandle
    description: Infrastructure controller providing MIPI isolation and TX enable

  power-domains:
    maxItems: 1

required:
  - compatible
  - reg
  - clocks
  - '#clock-cells'
  - mediatek,mmsys
  - mediatek,apmixedsys
  - mediatek,infracfg

additionalProperties: false

examples:
  - |
    clock-controller@c20a3800 {
        compatible = "mediatek,mt8377-mipi-tx";
        reg = <0xc20a3800 0x34>;
        clocks = <&clk26m>;
        #clock-cells = <0>;
        mediatek,mmsys = <&mmsys>;
        mediatek,apmixedsys = <&apmixedsys>;
        mediatek,infracfg = <&infracfg>;
    };
```

## Documentation/devicetree/bindings/clock/mediatek,mt8377-mmsys.yaml
```yaml
# SPDX-License-Identifier: (GPL-2.0-only OR BSD-2-Clause)
%YAML 1.2
---
$id: http://devicetree.org/schemas/clock/mediatek,mt8377-mmsys.yaml#
$schema: http://devicetree.org/meta-schemas/core.yaml#

title: MediaTek MT8377 multimedia clock gates

maintainers:
  - Michal Andrzejczak <mit.mis@gmail.com>

description:
  MMSYS provides the clock gates for the DPI engine and SMI memory fabric.
  Upstream clock sources are configured by firmware. Gate rates are unknown.

properties:
  compatible:
    items:
      - enum:
          - mediatek,mt8377-mmsys
          - mediatek,mt6577-mmsys
      - const: syscon

  reg:
    maxItems: 1

  clocks:
    items:
      - description: Register bus clock

  clock-names:
    items:
      - const: bus

  '#clock-cells':
    const: 1

  power-domains:
    maxItems: 1

required:
  - compatible
  - reg
  - '#clock-cells'

additionalProperties: false

dependencies:
  clocks: [clock-names]
  clock-names: [clocks]

examples:
  - |
    clock-controller@c2080000 {
        compatible = "mediatek,mt8377-mmsys", "syscon";
        reg = <0xc2080000 0x1000>;
        #clock-cells = <1>;
    };
```

## Documentation/devicetree/bindings/clock/mediatek,mt8377-pericfg.yaml
```yaml
# SPDX-License-Identifier: (GPL-2.0-only OR BSD-2-Clause)
%YAML 1.2
---
$id: http://devicetree.org/schemas/clock/mediatek,mt8377-pericfg.yaml#
$schema: http://devicetree.org/meta-schemas/core.yaml#

title: MediaTek MT8377 peripheral clock controller

maintainers:
  - Michal Andrzejczak <mit.mis@gmail.com>

description:
  The peripheral controller provides the PWM functional reference and clock
  gates, the dual I2C gate, and the MSDC0 and MSDC3 source selectors and gates. PWM
  channels4 through6 share one gate. MSDC0 and MSDC3 support the 26MHz and nominal
  WPLL197MHz source selections. USB supports the nominal WPLL61MHz source;
  its alternative source is not supported. UART2 uses the AXI clock divided
  by four and has an independent gate.

properties:
  compatible:
    enum:
      - mediatek,mt8377-pericfg
      - mediatek,mt6577-pericfg
  reg:
    maxItems: 1
  clocks:
    maxItems: 4
  clock-names:
    items:
      - const: axi
      - const: clk26m
      - const: wpll197
      - const: wpll61
  '#clock-cells':
    const: 1

required:
  - compatible
  - reg
  - clocks
  - clock-names
  - '#clock-cells'

additionalProperties: false

examples:
  - |
    #include <dt-bindings/clock/mediatek,mt8377-clk.h>
    clock-controller@c1000000 {
        compatible = "mediatek,mt8377-pericfg";
        reg = <0xc1000000 0x1000>;
        clocks = <&infracfg CLK_MT8377_AXI>, <&clk26m>,
                 <&apmixedsys CLK_MT8377_WPLL197>,
                 <&apmixedsys CLK_MT8377_WPLL61>;
        clock-names = "axi", "clk26m", "wpll197", "wpll61";
        #clock-cells = <1>;
    };
```
