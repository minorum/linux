## Documentation/devicetree/bindings/input/sprd,sc9830-keypad.yaml
```yaml
# SPDX-License-Identifier: (GPL-2.0-only OR BSD-2-Clause)
%YAML 1.2
---
$id: http://devicetree.org/schemas/input/sprd,sc9830-keypad.yaml#
$schema: http://devicetree.org/meta-schemas/core.yaml#

title: Spreadtrum SC9830 matrix keypad

maintainers:
  - minorum <mit.mis@gmail.com>

allOf:
  - $ref: matrix-keymap.yaml#
  - $ref: input.yaml#

properties:
  compatible:
    const: sprd,sc9830-keypad

  reg:
    maxItems: 1

  interrupts:
    maxItems: 1

  clocks:
    items:
      - description: APB interface gate
      - description: RTC scan gate

  clock-names:
    items:
      - const: apb
      - const: rtc

  resets:
    maxItems: 1

  keypad,num-rows:
    minimum: 1
    maximum: 8

  keypad,num-columns:
    minimum: 1
    maximum: 8

  linux,keymap: true
  autorepeat: true
  wakeup-source: true

required:
  - compatible
  - reg
  - interrupts
  - clocks
  - clock-names
  - resets
  - keypad,num-rows
  - keypad,num-columns
  - linux,keymap

unevaluatedProperties: false

examples:
  - |
    #include <dt-bindings/input/input.h>
    keypad@40250000 {
        compatible = "sprd,sc9830-keypad";
        reg = <0x40250000 0x1000>;
        interrupts = <0 36 4>;
        clocks = <&aon_gate 30>, <&aon_gate 31>;
        clock-names = "apb", "rtc";
        resets = <&aon_gate 8>;
        keypad,num-rows = <2>;
        keypad,num-columns = <3>;
        linux,keymap = <MATRIX_KEY(0, 0, KEY_VOLUMEUP)
                        MATRIX_KEY(0, 1, KEY_VOLUMEUP)
                        MATRIX_KEY(0, 2, KEY_HOMEPAGE)>;
        wakeup-source;
    };
```

## Documentation/devicetree/bindings/interconnect/sprd,sc9830-dcam-interconnect.yaml
```yaml
# SPDX-License-Identifier: GPL-2.0-only OR BSD-2-Clause
%YAML 1.2
---
$id: http://devicetree.org/schemas/interconnect/sprd,sc9830-dcam-interconnect.yaml#
$schema: http://devicetree.org/meta-schemas/core.yaml#

title: Spreadtrum SC9830 DCAM DDR arbitration

maintainers:
  - minorum <mit.mis@gmail.com>

description: |
  The DCAM to DDR path selects a fixed camera arbitration profile whenever
  aggregate interconnect demand is nonzero. Bandwidth requests do not change
  DDR frequency or guarantee a bandwidth. The provider restores its saved
  arbitration fields after the last demand is removed.

properties:
  compatible:
    const: sprd,sc9830-dcam-interconnect

  reg:
    maxItems: 1
    description: DDR controller register window.

  '#interconnect-cells':
    const: 1

  sprd,pmu:
    $ref: /schemas/types.yaml#/definitions/phandle
    description: PMU syscon containing multimedia power status.

required:
  - compatible
  - reg
  - '#interconnect-cells'
  - sprd,pmu

additionalProperties: false

examples:
  - |
    interconnect@30000000 {
        compatible = "sprd,sc9830-dcam-interconnect";
        reg = <0x30000000 0x1000>;
        #interconnect-cells = <1>;
        sprd,pmu = <&pmu>;
    };
```

## Documentation/devicetree/bindings/interrupt-controller/brcm,bcm2153-intc.yaml
```yaml
# SPDX-License-Identifier: (GPL-2.0-only OR BSD-2-Clause)
%YAML 1.2
---
$id: http://devicetree.org/schemas/interrupt-controller/brcm,bcm2153-intc.yaml#
$schema: http://devicetree.org/meta-schemas/core.yaml#

title: Broadcom BCM2153 application processor interrupt controller

maintainers:
  - minorum <mit.mis@gmail.com>

description: |
  The application processor controller has two banks of 32 interrupt slots,
  at offsets 0 and 0x100. Its register window is 0x200 bytes. This controller
  is separate from the modem processor interrupt controller.

  Interrupts routed to FIQ by firmware are outside the Linux IRQ domain.
  Their routing, enable bits and pending state are preserved. Linux does not
  provide the firmware FIQ handler. The flags cell must specify a qualified
  trigger type; unspecified trigger types are unsupported.

allOf:
  - $ref: /schemas/interrupt-controller.yaml#

properties:
  compatible:
    const: brcm,bcm2153-intc

  reg:
    maxItems: 1

  interrupt-controller: true

  '#address-cells':
    const: 0

  '#interrupt-cells':
    const: 2
    description: |
      The first cell is the AP interrupt number from 0 to 63. The second
      cell uses IRQ_TYPE_* flags for rising, falling, both edges, high level
      or low level. Firmware-routed FIQ sources cannot be mapped.

required:
  - compatible
  - reg
  - interrupt-controller
  - '#address-cells'
  - '#interrupt-cells'

additionalProperties: false

examples:
  - |
    interrupt-controller@8810000 {
        compatible = "brcm,bcm2153-intc";
        reg = <0x08810000 0x200>;
        interrupt-controller;
        #address-cells = <0>;
        #interrupt-cells = <2>;
    };
```

## Documentation/devicetree/bindings/interrupt-controller/sprd,sc9830-intc.yaml
```yaml
# SPDX-License-Identifier: GPL-2.0-only OR BSD-2-Clause
%YAML 1.2
---
$id: http://devicetree.org/schemas/interrupt-controller/sprd,sc9830-intc.yaml#
$schema: http://devicetree.org/meta-schemas/core.yaml#

title: Spreadtrum SC9830 auxiliary interrupt controller

maintainers:
  - minorum <mit.mis@gmail.com>

description:
  Four AP source banks and one shared always-on route bank accompany the GIC.
  Interrupt specifiers use three cells matching GIC SPI specifiers. PPIs must
  connect directly to the GIC. The auxiliary banks cover SPI sources 2-31,
  34-63, 66-95 and 98-124.

allOf:
  - $ref: /schemas/interrupt-controller.yaml#

properties:
  compatible:
    const: sprd,sc9830-intc

  reg:
    minItems: 5
    maxItems: 5

  reg-names:
    items:
      - const: intc0
      - const: intc1
      - const: intc2
      - const: intc3
      - const: aon

  clocks:
    minItems: 5
    maxItems: 5

  clock-names:
    items:
      - const: intc0
      - const: intc1
      - const: intc2
      - const: intc3
      - const: aon

  interrupt-controller: true

  '#interrupt-cells':
    const: 3

  '#address-cells':
    const: 0

required:
  - compatible
  - reg
  - reg-names
  - clocks
  - clock-names
  - interrupt-controller
  - '#interrupt-cells'
  - '#address-cells'

additionalProperties: false

examples:
  - |
    #include <dt-bindings/clock/sprd,sc9830-clk.h>

    interrupt-controller@71400000 {
        compatible = "sprd,sc9830-intc";
        reg = <0x71400000 0x1000>, <0x71500000 0x1000>,
              <0x71600000 0x1000>, <0x71700000 0x1000>,
              <0x40200000 0x1000>;
        reg-names = "intc0", "intc1", "intc2", "intc3", "aon";
        interrupt-controller;
        #interrupt-cells = <3>;
        #address-cells = <0>;
        interrupt-parent = <&gic>;
        clocks = <&apapb CLK_INTC0_EB>, <&apapb CLK_INTC1_EB>,
                 <&apapb CLK_INTC2_EB>, <&apapb CLK_INTC3_EB>,
                 <&aon_gate CLK_AON_INTC_EB>;
        clock-names = "intc0", "intc1", "intc2", "intc3", "aon";
    };
```

## Documentation/devicetree/bindings/mailbox/sprd-mailbox.yaml
```yaml
# SPDX-License-Identifier: (GPL-2.0 OR BSD-2-Clause)
%YAML 1.2
---
$id: http://devicetree.org/schemas/mailbox/sprd-mailbox.yaml#
$schema: http://devicetree.org/meta-schemas/core.yaml#

title: Spreadtrum mailbox controller

description: |
  The Samsung SM-J320FN compatible selects the installed firmware handover
  protocol. The additional resources expose shared counters temporarily during
  AP bank initialization and the separate PM processor bank for read-only checks.

maintainers:
  - Orson Zhai <orsonzhai@gmail.com>
  - Baolin Wang <baolin.wang7@gmail.com>
  - Chunyan Zhang <zhang.lyra@gmail.com>

properties:
  compatible:
    enum:
      - samsung,j320fn-mailbox
      - sprd,sc9830-mailbox
      - sprd,sc9860-mailbox
      - sprd,sc9863a-mailbox
      - sprd,ums9230-mailbox

  reg:
    minItems: 2
    items:
      - description: inbox registers' base address
      - description: outbox registers' base address
      - description: Temporary handover view of four PM shared-ring counters
      - description: Read-only PM processor outbox bank

  interrupts:
    minItems: 2
    maxItems: 3

  interrupt-names:
    minItems: 2
    items:
      - const: inbox
      - const: outbox
      - const: supp-outbox

  clocks:
    maxItems: 1

  clock-names:
    items:
      - const: enable

  "#mbox-cells":
    const: 1

required:
  - compatible
  - reg
  - interrupts
  - interrupt-names
  - "#mbox-cells"
  - clocks
  - clock-names

additionalProperties: false

allOf:
  - if:
      properties:
        compatible:
          const: samsung,j320fn-mailbox
    then:
      properties:
        reg:
          minItems: 4
        interrupts:
          maxItems: 2
        interrupt-names:
          maxItems: 2
    else:
      properties:
        reg:
          maxItems: 2

examples:
  - |
    #include <dt-bindings/interrupt-controller/arm-gic.h>
    mailbox: mailbox@400a0000 {
      compatible = "sprd,sc9860-mailbox";
      reg = <0x400a0000 0x8000>, <0x400a8000 0x8000>;
      #mbox-cells = <1>;
      clock-names = "enable";
      clocks = <&aon_gate 53>;
      interrupts = <GIC_SPI 28 IRQ_TYPE_LEVEL_HIGH>, <GIC_SPI 29 IRQ_TYPE_LEVEL_HIGH>;
      interrupt-names = "inbox", "outbox";
    };
...
```

## Documentation/devicetree/bindings/media/brcm,bcm2153-ge.yaml
```yaml
# SPDX-License-Identifier: (GPL-2.0-only OR BSD-2-Clause)
%YAML 1.2
---
$id: http://devicetree.org/schemas/media/brcm,bcm2153-ge.yaml#
$schema: http://devicetree.org/meta-schemas/core.yaml#

title: Broadcom BCM2153 2D graphics engine

maintainers:
  - minorum <mit.mis@gmail.com>

description:
  Memory-to-memory graphics engine supporting rectangle copies and pixel
  format conversion. The display bus interface is a separate peripheral.

properties:
  compatible:
    const: brcm,bcm2153-ge

  reg:
    maxItems: 1

  interrupts:
    maxItems: 1

required:
  - compatible
  - reg
  - interrupts

additionalProperties: false

examples:
  - |
    #include <dt-bindings/interrupt-controller/irq.h>

    graphics-engine@8040000 {
        compatible = "brcm,bcm2153-ge";
        reg = <0x08040000 0x48>;
        interrupt-parent = <&intc>;
        interrupts = <16 IRQ_TYPE_LEVEL_HIGH>;
    };
```

## Documentation/devicetree/bindings/media/sprd,sc9830-rotator.yaml
```yaml
# SPDX-License-Identifier: GPL-2.0-only OR BSD-2-Clause
%YAML 1.2
---
$id: http://devicetree.org/schemas/media/sprd,sc9830-rotator.yaml#
$schema: http://devicetree.org/meta-schemas/core.yaml#

title: Spreadtrum SC9830 DCAM rotator

maintainers:
  - minorum <mit.mis@gmail.com>

description: |
  The DCAM rotator uses contiguous RGB565 buffers with translation disabled.
  The entire DCAM engine must be exclusively owned by this consumer. The
  driver observes the MMU control word without programming translation.
  A five-second job budget supplies the deadline-derived interconnect vote.

properties:
  compatible:
    const: sprd,sc9830-rotator

  reg:
    items:
      - description: DCAM and rotator registers.
      - description: Legacy multimedia MMU control word.

  reg-names:
    items:
      - const: dcam
      - const: mmu

  interrupts:
    maxItems: 1

  clocks:
    maxItems: 2

  clock-names:
    items:
      - const: dcam
      - const: mmu

  resets:
    maxItems: 2

  reset-names:
    items:
      - const: rotator
      - const: all

  power-domains:
    maxItems: 1

  interconnects:
    maxItems: 1

  interconnect-names:
    const: dcam-ddr

  sprd,pmu:
    $ref: /schemas/types.yaml#/definitions/phandle
    description: PMU syscon containing multimedia power status.

  sprd,mm-ahb:
    $ref: /schemas/types.yaml#/definitions/phandle
    description: Multimedia clock gate syscon.

required:
  - compatible
  - reg
  - reg-names
  - interrupts
  - clocks
  - clock-names
  - resets
  - reset-names
  - power-domains
  - interconnects
  - interconnect-names
  - sprd,pmu
  - sprd,mm-ahb

additionalProperties: false
```

## Documentation/devicetree/bindings/mfd/brcm,bcm2153-reset.yaml
```yaml
# SPDX-License-Identifier: (GPL-2.0-only OR BSD-2-Clause)
%YAML 1.2
---
$id: http://devicetree.org/schemas/mfd/brcm,bcm2153-reset.yaml#
$schema: http://devicetree.org/meta-schemas/core.yaml#

title: Broadcom BCM2153 software reset controller

maintainers:
  - minorum <mit.mis@gmail.com>

description:
  The software reset register uses 16-bit accesses. Bit 3 requests a system
  reset. Other bits must be preserved.

properties:
  compatible:
    items:
      - const: brcm,bcm2153-reset
      - const: syscon
      - const: simple-mfd

  reg:
    maxItems: 1

  reg-io-width:
    const: 2

  reboot:
    $ref: /schemas/power/reset/syscon-reboot.yaml#
    type: object
    properties:
      offset:
        const: 0
      mask:
        const: 8
      value:
        const: 8
    required:
      - offset
      - mask
      - value

required:
  - compatible
  - reg
  - reg-io-width
  - reboot

additionalProperties: false

examples:
  - |
    system-controller@88e0000 {
        compatible = "brcm,bcm2153-reset", "syscon", "simple-mfd";
        reg = <0x088e0000 4>;
        reg-io-width = <2>;

        reboot {
            compatible = "syscon-reboot";
            offset = <0>;
            mask = <8>;
            value = <8>;
        };
    };
```

## Documentation/devicetree/bindings/mfd/brcm,bcm59035.yaml
```yaml
# SPDX-License-Identifier: (GPL-2.0-only OR BSD-2-Clause)
%YAML 1.2
---
$id: http://devicetree.org/schemas/mfd/brcm,bcm59035.yaml#
$schema: http://devicetree.org/meta-schemas/core.yaml#

title: Broadcom BCM59035 power management IC

maintainers:
  - minorum <mit.mis@gmail.com>

properties:
  compatible:
    const: brcm,bcm59035

  reg:
    maxItems: 1

  interrupts:
    maxItems: 1

  interrupt-controller: true

  "#interrupt-cells":
    const: 1
    description: |
      Interrupt number, calculated as eight times the zero-based status
      register index plus the bit number within that register.

  system-power-controller:
    type: boolean

  regulators:
    type: object
    additionalProperties: false

    properties:
      hcldo2:
        type: object
        $ref: /schemas/regulator/regulator.yaml#
        unevaluatedProperties: false

required:
  - compatible
  - reg
  - interrupts
  - interrupt-controller
  - '#interrupt-cells'

additionalProperties: false
```
