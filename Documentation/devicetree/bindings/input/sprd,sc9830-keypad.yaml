## Documentation/devicetree/bindings/mfd/mediatek,mt6329.yaml
```yaml
# SPDX-License-Identifier: (GPL-2.0-only OR BSD-2-Clause)
%YAML 1.2
---
$id: http://devicetree.org/schemas/mfd/mediatek,mt6329.yaml#
$schema: http://devicetree.org/meta-schemas/core.yaml#

title: MediaTek MT6329 power management IC

maintainers:
  - Michal Andrzejczak <mit.mis@gmail.com>

description:
  The MT6329 exposes its bank 0 registers at I2C address 0x60. This binding
  describes the fixed 3.3 V VUSB and selectable-voltage VMC regulators
  and the auxiliary ADC. Calibration registers occupy I2C address 0x61.

properties:
  compatible:
    const: mediatek,mt6329
  reg:
    const: 0x60
  clocks:
    maxItems: 1
    description: External 32.768 kHz reference clock.
  mediatek,external-charger:
    type: boolean
    description:
      Battery charging uses an external charger. Disable the internal
      charger, current DAC and charger watchdog before enabling PMIC
      function devices.
  current-sensor:
    $ref: /schemas/iio/adc/mediatek,mt6329-fgadc.yaml#
  adc:
    $ref: /schemas/iio/adc/mediatek,mt6359-auxadc.yaml#
    properties:
      compatible:
        const: mediatek,mt6329-auxadc
    unevaluatedProperties: false
  regulators:
    type: object
    properties:
      vusb:
        type: object
        $ref: /schemas/regulator/regulator.yaml#
        properties:
          regulator-min-microvolt:
            const: 3300000
          regulator-max-microvolt:
            const: 3300000
        unevaluatedProperties: false
      vmc:
        type: object
        $ref: /schemas/regulator/regulator.yaml#
        properties:
          regulator-min-microvolt:
            minimum: 1300000
            maximum: 3300000
          regulator-max-microvolt:
            minimum: 1300000
            maximum: 3300000
        unevaluatedProperties: false
    additionalProperties: false

required:
  - compatible
  - reg
  - regulators

additionalProperties: false

examples:
  - |
    i2c {
        #address-cells = <1>;
        #size-cells = <0>;
        pmic@60 {
            compatible = "mediatek,mt6329";
            reg = <0x60>;
            adc {
                compatible = "mediatek,mt6329-auxadc";
                #io-channel-cells = <1>;
            };
            regulators {
                vusb {
                    regulator-name = "vusb";
                    regulator-min-microvolt = <3300000>;
                    regulator-max-microvolt = <3300000>;
                    regulator-always-on;
                };
                vmc {
                    regulator-name = "vmc";
                    regulator-min-microvolt = <3300000>;
                    regulator-max-microvolt = <3300000>;
                    regulator-always-on;
                };
            };
        };
    };
```

## Documentation/devicetree/bindings/mfd/sprd,sc9830-syscon.yaml
```yaml
# SPDX-License-Identifier: GPL-2.0-only OR BSD-2-Clause
%YAML 1.2
---
$id: http://devicetree.org/schemas/mfd/sprd,sc9830-syscon.yaml#
$schema: http://devicetree.org/meta-schemas/core.yaml#

title: Spreadtrum SC9830 shared system registers

maintainers:
  - minorum <mit.mis@gmail.com>

properties:
  compatible:
    items:
      - enum:
          - sprd,sc9830-ddr-phy
          - sprd,sc9830-pmu
          - sprd,sc9830-mm-clk
      - const: syscon

  reg:
    maxItems: 1

required:
  - compatible
  - reg

additionalProperties: false

examples:
  - |
    syscon@402b0000 {
        compatible = "sprd,sc9830-pmu", "syscon";
        reg = <0x402b0000 0x3000>;
    };
```

## Documentation/devicetree/bindings/mmc/brcm,bcm2153-sdhci.yaml
```yaml
# SPDX-License-Identifier: (GPL-2.0-only OR BSD-2-Clause)
%YAML 1.2
---
$id: http://devicetree.org/schemas/mmc/brcm,bcm2153-sdhci.yaml#
$schema: http://devicetree.org/meta-schemas/core.yaml#

title: Broadcom BCM2153 SDHCI controller

maintainers:
  - minorum <mit.mis@gmail.com>

allOf:
  - $ref: mmc-controller.yaml#

description:
  Each host has an SDHCI register window and a separate interrupt mask.
  Its external gate/divider output is supplied by the clock controller.
  The card supply must be enabled before selecting powered-init followed
  by powered. These states clear and configure the mux before host reset
  and card enumeration.
  External reset is provided by the SDIO wrapper reset controller.

properties:
  compatible:
    const: brcm,bcm2153-sdhci

  reg:
    items:
      - description: SDHCI registers
      - description: Interrupt mask word

  reg-names:
    items:
      - const: host
      - const: interrupt-mask

  clocks:
    maxItems: 1

  interrupts:
    maxItems: 1

  resets:
    maxItems: 1

  pinctrl-0: true
  pinctrl-1: true

  pinctrl-names:
    items:
      - const: powered-init
      - const: powered

required:
  - compatible
  - reg
  - reg-names
  - clocks
  - interrupts
  - resets
  - vmmc-supply
  - pinctrl-0
  - pinctrl-1
  - pinctrl-names

unevaluatedProperties: false

examples:
  - |
    mmc@8120000 {
        compatible = "brcm,bcm2153-sdhci";
        reg = <0x08120000 0x100>, <0x08128008 0x4>;
        reg-names = "host", "interrupt-mask";
        resets = <&sd1_reset>;
        clocks = <&sd1_clock>;
        interrupts = <26 4>;
        vmmc-supply = <&vmmc>;
        pinctrl-names = "powered-init", "powered";
        pinctrl-0 = <&sd1_clear_pins>;
        pinctrl-1 = <&sd1_pins>;
        bus-width = <4>;
        max-frequency = <25000000>;
    };
```

## Documentation/devicetree/bindings/mmc/mediatek,mt6577-mmc-ram.yaml
```yaml
# SPDX-License-Identifier: GPL-2.0-only OR BSD-2-Clause
%YAML 1.2
---
$id: http://devicetree.org/schemas/mmc/mediatek,mt6577-mmc-ram.yaml#
$schema: http://devicetree.org/meta-schemas/core.yaml#

title: MediaTek MT6577 preinitialized eMMC controller

maintainers:
  - Michal Andrzejczak <mit.mis@gmail.com>

description: |
  Polling PIO eMMC host retaining power and electrical pad settings from
  the preceding boot stage. ECO revision 4 digital timing is initialized by
  the driver. This interface does not provide cold board power-up, DMA,
  high-speed modes or system power management.
  The source clock provider owns the controller gate and describes the
  boot-selected source.

allOf:
  - $ref: mmc-controller.yaml#

properties:
  compatible:
    const: mediatek,mt6577-mmc-ram

  reg:
    maxItems: 1

  clocks:
    maxItems: 1

  clock-names:
    const: source

  bus-width:
    enum: [1, 4]

  max-frequency:
    maximum: 12000000

  non-removable: true

required:
  - compatible
  - reg
  - clocks
  - clock-names
  - bus-width
  - max-frequency
  - non-removable

unevaluatedProperties: false
```

## Documentation/devicetree/bindings/mmc/mediatek,mt6577-mmc.yaml
```yaml
# SPDX-License-Identifier: GPL-2.0-only OR BSD-2-Clause
%YAML 1.2
---
$id: http://devicetree.org/schemas/mmc/mediatek,mt6577-mmc.yaml#
$schema: http://devicetree.org/meta-schemas/core.yaml#

title: MediaTek MT6577 legacy eMMC controller

maintainers:
  - Michal Andrzejczak <mit.mis@gmail.com>

description: |
  Revision 4 polling eMMC controller with native clock-gate, controller
  reset, timing and electrical-pad initialization. The supported configuration
  is nonremovable, up to 4 bits wide, with legacy and SDR high-speed operation
  up to 52 MHz.
  Pad defaults use the drive encoding qualified on the MODECOM FreeTAB 8001.
  Card power is retained, matching the stock host-0 software policy. Supply
  switching and external card reset are not part of this interface. Active
  SoC pin routing remains configured by the platform. Basic DMA uses a
  32-bit coherent bounce buffer, with PIO fallback. DDR, HS200, HS400 and
  system power management are not supported.
  The source clock provider owns the controller gate and describes the
  boot-selected source.

allOf:
  - $ref: mmc-controller.yaml#

properties:
  compatible:
    const: mediatek,mt6577-mmc

  reg:
    maxItems: 1

  clocks:
    maxItems: 1

  clock-names:
    const: source

  bus-width:
    enum: [1, 4]

  max-frequency:
    maximum: 52000000

  cap-mmc-highspeed: true

  mmc-ddr-1_2v: false
  mmc-ddr-1_8v: false
  mmc-ddr-3_3v: false
  mmc-hs200-1_2v: false
  mmc-hs200-1_8v: false
  mmc-hs400-1_2v: false
  mmc-hs400-1_8v: false
  mmc-hs400-enhanced-strobe: false

  non-removable: true

required:
  - compatible
  - reg
  - clocks
  - clock-names
  - bus-width
  - max-frequency
  - non-removable

unevaluatedProperties: false
```

## Documentation/devicetree/bindings/mmc/mediatek,mt6628-wmt.yaml
```yaml
# SPDX-License-Identifier: GPL-2.0-only OR BSD-2-Clause
%YAML 1.2
---
$id: http://devicetree.org/schemas/mmc/mediatek,mt6628-wmt.yaml#
$schema: http://devicetree.org/meta-schemas/core.yaml#

title: MediaTek MT6628 UART management and power sequencing

maintainers:
  - Michal Andrzejczak <mit.mis@gmail.com>

description: |
  The MT6628 combo chip has a UART management interface using WMT over STP.
  Its common firmware must be initialized before the WLAN SDIO function can
  enumerate. The management node is a child of the UART controller and is
  referenced by the SDIO host through mmc-pwrseq.

  Reset, the LDO enable, two power-management enables and the sleep clock
  belong to this common power sequence. The default pin state leaves the
  UART signals as undriven GPIO inputs; the active state selects UART after
  the chip supply and sleep clock have stabilized.

properties:
  compatible:
    const: mediatek,mt6628-wmt

  reset-gpios:
    maxItems: 1
    description: Chip reset, asserted before power is enabled.

  enable-gpios:
    maxItems: 1
    description: LDO enable supplying the combo chip.

  power-gpios:
    minItems: 2
    maxItems: 2
    description: Two power-management enable signals, in assertion order.

  clocks:
    maxItems: 1
    description: 32.768 kHz sleep clock.

  clock-names:
    const: rtc

  mediatek,antenna-mode:
    $ref: /schemas/types.yaml#/definitions/uint32
    enum: [1, 2, 3, 4]
    description:
      Antenna-routing profile used by the coexistence controller. The
      firmware numbers these profiles from 1 to 4; select the profile
      matching the module's antenna wiring.

  pinctrl-names:
    items:
      - const: default
      - const: active

  pinctrl-0: true
  pinctrl-1: true

required:
  - compatible
  - reset-gpios
  - enable-gpios
  - power-gpios
  - clocks
  - clock-names
  - mediatek,antenna-mode
  - pinctrl-names
  - pinctrl-0
  - pinctrl-1

additionalProperties: false

examples:
  - |
    #include <dt-bindings/gpio/gpio.h>

    serial {
        connectivity: mcu {
            compatible = "mediatek,mt6628-wmt";
            reset-gpios = <&gpio 59 GPIO_ACTIVE_LOW>;
            enable-gpios = <&gpio 183 GPIO_ACTIVE_HIGH>;
            power-gpios = <&gpio 185 GPIO_ACTIVE_HIGH>,
                          <&gpio 149 GPIO_ACTIVE_HIGH>;
            clocks = <&rtc_clock>;
            clock-names = "rtc";
            mediatek,antenna-mode = <1>;
            pinctrl-names = "default", "active";
            pinctrl-0 = <&combo_safe>;
            pinctrl-1 = <&combo_uart>;
        };
    };
```

## Documentation/devicetree/bindings/mmc/sprd,sc9830-sdhci.yaml
```yaml
# SPDX-License-Identifier: GPL-2.0-only OR BSD-2-Clause
%YAML 1.2
---
$id: http://devicetree.org/schemas/mmc/sprd,sc9830-sdhci.yaml#
$schema: http://devicetree.org/meta-schemas/core.yaml#

title: Spreadtrum SC9830 eMMC controller

maintainers:
  - minorum <mit.mis@gmail.com>

description:
  eMMC access with firmware-initialized power, an owned host
  clock gate, reset and board pin configuration.

allOf:
  - $ref: mmc-controller.yaml#

properties:
  compatible:
    const: sprd,sc9830-sdhci
  reg:
    maxItems: 1
  interrupts:
    maxItems: 1
  clocks:
    maxItems: 1
  resets:
    maxItems: 1
  reset-names:
    const: host
  bus-width:
    enum: [1, 4, 8]
  max-frequency:
    maximum: 52000000

required:
  - compatible
  - reg
  - interrupts
  - clocks
  - resets
  - reset-names
  - pinctrl-names
  - pinctrl-0
  - non-removable

unevaluatedProperties: false
```

## Documentation/devicetree/bindings/mmc/sprd,sc9830-sdio.yaml
```yaml
# SPDX-License-Identifier: GPL-2.0-only OR BSD-2-Clause
%YAML 1.2
---
$id: http://devicetree.org/schemas/mmc/sprd,sc9830-sdio.yaml#
$schema: http://devicetree.org/meta-schemas/core.yaml#

title: Spreadtrum SC9830 SDIO controller

maintainers:
  - minorum <mit.mis@gmail.com>

allOf:
  - $ref: mmc-controller.yaml#

properties:
  compatible:
    const: sprd,sc9830-sdio

  reg:
    maxItems: 1

  interrupts:
    maxItems: 1

  clocks:
    maxItems: 1

  bus-width:
    const: 4

  max-frequency:
    maximum: 50000000

  sprd,phy-delay:
    $ref: /schemas/types.yaml#/definitions/uint32-array
    minItems: 3
    maxItems: 3
    description:
      Write, positive-edge read and negative-edge read delay register values,
      in that order, restored after controller reset.

required:
  - compatible
  - reg
  - interrupts
  - clocks
  - bus-width
  - sprd,phy-delay

unevaluatedProperties: false

examples:
  - |
    mmc@20400000 {
        compatible = "sprd,sc9830-sdio";
        reg = <0x20400000 0x1000>;
        interrupts = <0 58 4>;
        clocks = <&sdio1_clk>;
        bus-width = <4>;
        max-frequency = <50000000>;
        sprd,phy-delay = <3 3 3>;
        non-removable;
        no-sd;
        no-mmc;
        no-1-8-v;
    };
```

## Documentation/devicetree/bindings/net/wireless/sprd,sc2331-wifi.yaml
```yaml
# SPDX-License-Identifier: GPL-2.0-only OR BSD-2-Clause
%YAML 1.2
---
$id: http://devicetree.org/schemas/net/wireless/sprd,sc2331-wifi.yaml#
$schema: http://devicetree.org/meta-schemas/core.yaml#

title: Spreadtrum SC2331 SDIO Wi-Fi function

maintainers:
  - minorum <mit.mis@gmail.com>

description: |
  The SDIO function depends on a UART bootstrap controller which owns its
  power supplies, clock, reset and firmware startup readiness indication.

allOf:
  - $ref: /schemas/net/wireless/wireless-controller.yaml#

properties:
  compatible:
    const: sprd,sc2331-wifi

  reg:
    const: 1

  interrupts:
    maxItems: 1
    description: Receive data ready interrupt

  nvmem-cells:
    maxItems: 1

  nvmem-cell-names:
    const: mac-address

  sprd,boot-controller:
    $ref: /schemas/types.yaml#/definitions/phandle
    description: UART bootstrap controller for this connectivity device

required:
  - compatible
  - reg
  - sprd,boot-controller

unevaluatedProperties: false
...
```

## Documentation/devicetree/bindings/net/wireless/sprd,sc2331.yaml
```yaml
# SPDX-License-Identifier: GPL-2.0-only OR BSD-2-Clause
%YAML 1.2
---
$id: http://devicetree.org/schemas/net/wireless/sprd,sc2331.yaml#
$schema: http://devicetree.org/meta-schemas/core.yaml#

title: Spreadtrum SC2331 connectivity controller UART bootstrap

maintainers:
  - minorum <mit.mis@gmail.com>

description: |
  The connectivity controller boots through a UART ROM loader before its
  SDIO firmware transport becomes available. The UART child owns the shared
  connectivity supply, reference clock and active-low reset.

allOf:
  - $ref: /schemas/serial/serial-peripheral-props.yaml#

properties:
  compatible:
    const: sprd,sc2331

  clocks:
    maxItems: 1

  clock-names:
    const: ext_clock

  reset-gpios:
    maxItems: 1

  host-wake-gpios:
    description: Connectivity controller wake and boot readiness indication
    maxItems: 1

  device-wake-gpios:
    description: Host output requesting connectivity controller wake
    maxItems: 1

  vddcon-supply:
    description: Factory-calibrated 1.6 V connectivity supply

required:
  - compatible
  - clocks
  - clock-names
  - reset-gpios
  - vddcon-supply

unevaluatedProperties: false
...
```
