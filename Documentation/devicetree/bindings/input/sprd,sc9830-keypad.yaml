## Documentation/devicetree/bindings/nvmem/sprd,sc9830-efuse.yaml
```yaml
# SPDX-License-Identifier: GPL-2.0-only OR BSD-2-Clause
%YAML 1.2
---
$id: http://devicetree.org/schemas/nvmem/sprd,sc9830-efuse.yaml#
$schema: http://devicetree.org/meta-schemas/core.yaml#

title: Spreadtrum SC9830 application processor efuse

maintainers:
  - minorum <mit.mis@gmail.com>

description: Read-only access to sixteen 32-bit efuse blocks.

allOf:
  - $ref: nvmem.yaml#

properties:
  compatible:
    const: sprd,sc9830-efuse
  reg:
    maxItems: 1
  clocks:
    maxItems: 1
  hwlocks:
    maxItems: 1

required:
  - compatible
  - reg
  - clocks
  - hwlocks

unevaluatedProperties: false
```

## Documentation/devicetree/bindings/opp/opp-v2-sprd-sc9830.yaml
```yaml
# SPDX-License-Identifier: GPL-2.0-only OR BSD-2-Clause
%YAML 1.2
---
$id: http://devicetree.org/schemas/opp/opp-v2-sprd-sc9830.yaml#
$schema: http://devicetree.org/meta-schemas/core.yaml#

title: Spreadtrum SC9830 calibrated CPU operating points

maintainers:
  - minorum <mit.mis@gmail.com>

description: |
  The shared Cortex-A7 cluster uses nominal operating-point voltages with
  request-dependent SC2723 factory compensation. The calibration code is
  centered at 64 and adjusted by 32 times the additional code minus one.
  The resulting signed delta scales by nominal millivolts divided by 900,
  truncating toward zero, then by 3125 microvolts. This offset is added to
  the nominal voltage before programming the raw CPU supply selector.

allOf:
  - $ref: opp-v2-base.yaml#

properties:
  compatible:
    const: operating-points-v2-sprd-sc9830

  opp-shared: true

  nvmem-cells:
    items:
      - description: Calibration validity bit 7, must be clear
      - description: CPU calibration bits 14 through 20
      - description: Additional CPU calibration bits 254 through 255

  nvmem-cell-names:
    items:
      - const: calibration_state
      - const: vddarm
      - const: additional

patternProperties:
  '^opp-[0-9]+$':
    type: object
    properties:
      opp-hz: true
      opp-microvolt: true
      opp-suspend: true
    required:
      - opp-hz
      - opp-microvolt
    unevaluatedProperties: false

required:
  - compatible
  - opp-shared
  - nvmem-cells
  - nvmem-cell-names

unevaluatedProperties: false
```

## Documentation/devicetree/bindings/perf/sprd,sc9830-ddr-pmu.yaml
```yaml
# SPDX-License-Identifier: (GPL-2.0-only OR BSD-2-Clause)
%YAML 1.2
---
$id: http://devicetree.org/schemas/perf/sprd,sc9830-ddr-pmu.yaml#
$schema: http://devicetree.org/meta-schemas/core.yaml#

title: Spreadtrum SC9830 DDR AXI performance monitor

maintainers:
  - minorum <mit.mis@gmail.com>

description: |
  Ten AXI ports each expose six fixed raw counters. The shared PUB block
  controls global counting and per-port clocks. Hardware completion interrupts
  delimit windows. Bandwidth and latency units are not calibrated. Monitor
  clock gates and reset bits share one PUB register. Firmware must leave
  monitoring idle for Linux ownership.

properties:
  compatible:
    const: sprd,sc9830-ddr-pmu

  reg:
    items:
      - description: Ten AXI monitor banks
      - description: PUB global control and clock gates

  reg-names:
    items:
      - const: axi
      - const: pub

  interrupts:
    maxItems: 1

required:
  - compatible
  - reg
  - reg-names
  - interrupts

additionalProperties: false

examples:
  - |
    #include <dt-bindings/interrupt-controller/arm-gic.h>

    pmu@30040000 {
        compatible = "sprd,sc9830-ddr-pmu";
        reg = <0x30040000 0xa0000>, <0x30020000 0x8>;
        reg-names = "axi", "pub";
        interrupt-parent = <&intc>;
        interrupts = <GIC_SPI 86 IRQ_TYPE_LEVEL_HIGH>;
    };
```

## Documentation/devicetree/bindings/phy/brcm,bcm2153-usb-phy.yaml
```yaml
# SPDX-License-Identifier: (GPL-2.0-only OR BSD-2-Clause)
%YAML 1.2
---
$id: http://devicetree.org/schemas/phy/brcm,bcm2153-usb-phy.yaml#
$schema: http://devicetree.org/meta-schemas/core.yaml#

title: Broadcom BCM2153 USB PHY

maintainers:
  - minorum <mit.mis@gmail.com>

description:
  The integrated USB PHY has a wrapper control word and a separate analog
  control word in the system configuration block. Device-mode initialization
  uses both resources. The UTMI interface is eight bits wide.

properties:
  compatible:
    const: brcm,bcm2153-usb-phy

  reg:
    items:
      - description: USB wrapper control
      - description: USB analog configuration

  reg-names:
    items:
      - const: wrapper
      - const: analog

  '#phy-cells':
    const: 0

required:
  - compatible
  - reg
  - reg-names
  - '#phy-cells'

additionalProperties: false

examples:
  - |
    phy@8280000 {
        compatible = "brcm,bcm2153-usb-phy";
        reg = <0x08280000 4>, <0x088800a4 4>;
        reg-names = "wrapper", "analog";
        #phy-cells = <0>;
    };
```

## Documentation/devicetree/bindings/phy/mediatek,mt8377-usb-phy.yaml
```yaml
# SPDX-License-Identifier: (GPL-2.0-only OR BSD-2-Clause)
%YAML 1.2
---
$id: http://devicetree.org/schemas/phy/mediatek,mt8377-usb-phy.yaml#
$schema: http://devicetree.org/meta-schemas/core.yaml#

title: MediaTek MT8377 USB 2.0 PHY

maintainers:
  - Michal Andrzejczak <mit.mis@gmail.com>

properties:
  compatible:
    enum:
      - mediatek,mt8377-usb-phy
      - mediatek,mt6577-usb-phy
  reg:
    maxItems: 1
  clocks:
    maxItems: 2
  clock-names:
    items:
      - const: upll
      - const: bus
  vusb33-supply:
    description: 3.3V analog supply
  mediatek,bc11:
    type: boolean
    description:
      Enable BC1.1 source detection in the MT6329 PMIC supplying vusb33.
  '#phy-cells':
    const: 0

required:
  - compatible
  - reg
  - clocks
  - clock-names
  - vusb33-supply
  - '#phy-cells'

additionalProperties: false

examples:
  - |
    phy@c1260800 {
        compatible = "mediatek,mt8377-usb-phy";
        reg = <0xc1260800 0x800>;
        clocks = <&upll>, <&usb_clk>;
        clock-names = "upll", "bus";
        vusb33-supply = <&vusb>;
        #phy-cells = <0>;
    };
```

## Documentation/devicetree/bindings/pinctrl/sprd,sc9830-pinctrl.yaml
```yaml
# SPDX-License-Identifier: GPL-2.0-only OR BSD-2-Clause
%YAML 1.2
---
$id: http://devicetree.org/schemas/pinctrl/sprd,sc9830-pinctrl.yaml#
$schema: http://devicetree.org/meta-schemas/core.yaml#

title: Spreadtrum SC9830 pin multiplexer

maintainers:
  - minorum <mit.mis@gmail.com>

description:
  The controller has per-pad registers and separate global controls.
  The I2C2, UART0, SDIO1 and eMMC alternate functions are supported. GPIO
  mode selects the pad function and does not configure the GPIO controller.
  The panel-reset group selects GPIO mode on LCM_RSTN.

allOf:
  - $ref: pinctrl.yaml#

properties:
  compatible:
    const: sprd,sc9830-pinctrl

  reg:
    maxItems: 1

patternProperties:
  '-pins$':
    type: object
    allOf:
      - $ref: pinmux-node.yaml#
    unevaluatedProperties: false
    properties:
      function:
        enum: [i2c2, gpio, uart0, sdio1, emmc]
      groups:
        items:
          enum: [i2c2, uart0, sdio1, emmc-data, emmc-clock, panel-reset]
        maxItems: 1
      pins: false
      bias-disable:
        type: boolean
      bias-pull-up:
        type: boolean
      bias-pull-down:
        type: boolean
      sprd,drive-level:
        description: Raw two-bit drive selector; no current in milliamps is implied.
        $ref: /schemas/types.yaml#/definitions/uint32
        minimum: 0
        maximum: 3
    required:
      - function
      - groups

required:
  - compatible
  - reg

additionalProperties: false

examples:
  - |
    pinctrl@402a0000 {
        compatible = "sprd,sc9830-pinctrl";
        reg = <0x402a0000 0x1000>;

        i2c2-pins {
            function = "i2c2";
            groups = "i2c2";
        };
    };
```
