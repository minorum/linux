## Documentation/devicetree/bindings/firmware/mediatek,mt6785-cpu-pm.yaml
```yaml
# SPDX-License-Identifier: (GPL-2.0-only OR BSD-2-Clause)
%YAML 1.2
---
$id: http://devicetree.org/schemas/firmware/mediatek,mt6785-cpu-pm.yaml#
$schema: http://devicetree.org/meta-schemas/core.yaml#

title: MediaTek MT6785 CPU power management firmware

maintainers:
  - minorum <mit.mis@gmail.com>

description: |
  Legacy MT6785 secure firmware requires a SiP completion call on a surviving
  CPU after PSCI reports a target CPU offline. Function 0xc2000212 completes
  power-down for the core index supplied in x1, with other arguments zero.
  Core indices 0 through 7 correspond to MPIDR Aff1; other affinities are zero.
  The call is idempotent for an already-off target and returns zero on success.
  This node describes firmware that implements and requires this service.
  Firmware using standard PSCI power-down without this service omits the node.

properties:
  $nodename:
    const: cpu-power-management

  compatible:
    const: mediatek,mt6785-cpu-pm

required:
  - compatible

additionalProperties: false

examples:
  - |
    firmware {
        cpu-power-management {
            compatible = "mediatek,mt6785-cpu-pm";
        };
    };
```

## Documentation/devicetree/bindings/iio/adc/brcm,bcm2153-auxadc.yaml
```yaml
# SPDX-License-Identifier: (GPL-2.0-only OR BSD-2-Clause)
%YAML 1.2
---
$id: http://devicetree.org/schemas/iio/adc/brcm,bcm2153-auxadc.yaml#
$schema: http://devicetree.org/meta-schemas/core.yaml#

title: Broadcom BCM2153 auxiliary ADC

maintainers:
  - minorum <mit.mis@gmail.com>

description:
  Eight-channel auxiliary ADC with 8-bit results and 16-bit register accesses.
  The controller must be exclusively owned by the application processor.

properties:
  compatible:
    const: brcm,bcm2153-auxadc

  reg:
    maxItems: 1

  "#io-channel-cells":
    const: 1

required:
  - compatible
  - reg
  - "#io-channel-cells"

additionalProperties: false

examples:
  - |
    adc@8830020 {
        compatible = "brcm,bcm2153-auxadc";
        reg = <0x08830020 0x0a>;
        #io-channel-cells = <1>;
    };
```

## Documentation/devicetree/bindings/nvmem/rmem.yaml
```yaml
# SPDX-License-Identifier: (GPL-2.0-only OR BSD-2-Clause)
%YAML 1.2
---
$id: http://devicetree.org/schemas/nvmem/rmem.yaml#
$schema: http://devicetree.org/meta-schemas/core.yaml#

title: Reserved Memory Based nvmem Device

description:
  Reserved memory containing configuration retained by boot firmware. On
  Samsung GT-S5620, the region contains two little-endian 16-bit battery
  voltage calibration words from the dependent parameter table.

maintainers:
  - Nicolas Saenz Julienne <nsaenzjulienne@suse.de>

allOf:
  - $ref: nvmem.yaml#

properties:
  compatible:
    items:
      - enum:
          - mobileye,eyeq5-bootloader-config
          - raspberrypi,bootloader-config
          - raspberrypi,bootloader-public-key
          - samsung,gt-s5620-battery-calibration
      - const: nvmem-rmem

  reg:
    maxItems: 1

  no-map:
    $ref: /schemas/types.yaml#/definitions/flag
    description:
      Avoid creating a virtual mapping of the region as part of the OS'
      standard mapping of system memory.

required:
  - compatible
  - no-map

unevaluatedProperties: false

examples:
  - |
        reserved-memory {
                #address-cells = <1>;
                #size-cells = <1>;

                blconfig: nvram@10000000 {
                        compatible = "raspberrypi,bootloader-config", "nvmem-rmem";
                        #address-cells = <1>;
                        #size-cells = <1>;
                        reg = <0x10000000 0x1000>;
                        no-map;
                };
        };

...
```

## Documentation/devicetree/bindings/power/supply/brcm,bcm59035-charger.yaml
```yaml
# SPDX-License-Identifier: (GPL-2.0-only OR BSD-2-Clause)
%YAML 1.2
---
$id: http://devicetree.org/schemas/power/supply/brcm,bcm59035-charger.yaml#
$schema: http://devicetree.org/meta-schemas/core.yaml#

title: Broadcom BCM59035 charger

maintainers:
  - minorum <mit.mis@gmail.com>

description:
  Charger function of the BCM59035 power management IC.

allOf:
  - $ref: power-supply.yaml#

properties:
  compatible:
    const: brcm,bcm59035-charger

  monitored-battery: true

  power-supplies:
    maxItems: 1
    description:
      Input power supply. If this references a plain USB-B connector whose
      parent has usb-role-switch, the PMIC USB-present detector is connected
      to that connector's VBUS and controls its device or disconnected role.
      The charger is the sole physical VBUS detector for that port. A default
      USB role and another connector role controller must not be configured.

required:
  - compatible

unevaluatedProperties: false

examples:
  - |
    charger {
        compatible = "brcm,bcm59035-charger";
    };
```

## Documentation/devicetree/bindings/power/supply/samsung,gt-s5620-battery.yaml
```yaml
# SPDX-License-Identifier: (GPL-2.0-only OR BSD-2-Clause)
%YAML 1.2
---
$id: http://devicetree.org/schemas/power/supply/samsung,gt-s5620-battery.yaml#
$schema: http://devicetree.org/meta-schemas/core.yaml#

title: Samsung GT-S5620 battery monitor

maintainers:
  - minorum <mit.mis@gmail.com>

description:
  Battery voltage and thermistor inputs connected to the BCM2153 auxiliary
  ADC. Voltage calibration is retained by the boot firmware as two
  little-endian 16-bit words corresponding to 3.3 V and 4.2 V. Values below
  255 encode a single sample; larger values encode a sum of sixteen samples.

allOf:
  - $ref: power-supply.yaml#

properties:
  compatible:
    const: samsung,gt-s5620-battery

  io-channels:
    items:
      - description: Battery voltage
      - description: Battery thermistor

  io-channel-names:
    items:
      - const: voltage
      - const: temperature

  nvmem-cells:
    items:
      - description: Voltage calibration at 3.3 V
      - description: Voltage calibration at 4.2 V

  nvmem-cell-names:
    items:
      - const: voltage-3v3
      - const: voltage-4v2

  monitored-battery: true

  power-supplies:
    maxItems: 1
    description: Charger providing status for software capacity estimation.

required:
  - compatible
  - io-channels
  - io-channel-names
  - nvmem-cells
  - nvmem-cell-names
  - monitored-battery

unevaluatedProperties: false

examples:
  - |
    battery-monitor {
        compatible = "samsung,gt-s5620-battery";
        io-channels = <&adc 2>, <&adc 4>;
        io-channel-names = "voltage", "temperature";
        nvmem-cells = <&battery_cal_3v3>, <&battery_cal_4v2>;
        nvmem-cell-names = "voltage-3v3", "voltage-4v2";
        monitored-battery = <&battery>;
    };
```

## Documentation/devicetree/bindings/power/supply/siliconmitus,sm5701.yaml
```yaml
# SPDX-License-Identifier: (GPL-2.0-only OR BSD-2-Clause)
%YAML 1.2
---
$id: http://devicetree.org/schemas/power/supply/siliconmitus,sm5701.yaml#
$schema: http://devicetree.org/meta-schemas/core.yaml#

title: Silicon Mitus SM5701 charger

maintainers:
  - minorum <mit.mis@gmail.com>

description:
  The SM5701 integrates a battery charger, a boost converter and flash LED
  control. The charger input status is accessible over I2C.

properties:
  compatible:
    const: siliconmitus,sm5701

  reg:
    maxItems: 1

  interrupts:
    maxItems: 1

  wakeup-source: true

  io-channels:
    maxItems: 1
    description:
      External battery temperature channel for charging supervision. The
      channel must provide processed temperature in milli-degrees Celsius.

  io-channel-names:
    const: battery-temperature

  monitored-battery:
    $ref: /schemas/types.yaml#/definitions/phandle
    description:
      Battery profile containing the safe temperature range in alert-celsius.

  led:
    type: object
    $ref: /schemas/leds/common.yaml#
    unevaluatedProperties: false
    properties:
      led-max-microamp:
        minimum: 10000
        maximum: 320000
        multipleOf: 10000
    required:
      - led-max-microamp

required:
  - compatible
  - reg

dependencies:
  io-channels: [io-channel-names, monitored-battery]
  io-channel-names: [io-channels]
  monitored-battery: [io-channels]

additionalProperties: false

examples:
  - |
    i2c {
      #address-cells = <1>;
      #size-cells = <0>;

      charger@49 {
        compatible = "siliconmitus,sm5701";
        reg = <0x49>;
      };
    };
```
